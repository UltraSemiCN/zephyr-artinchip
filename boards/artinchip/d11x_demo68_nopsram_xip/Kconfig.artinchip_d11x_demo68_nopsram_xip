## boards/artinchip/d11x_demo68_nopsram_xip/Kconfig.artinchip_d11x_demo68_nopsram_xip
```kconfig
# SPDX-FileCopyrightText: Copyright (c) 2026 UltraSemi Technology Development Co., Ltd.
# SPDX-License-Identifier: Apache-2.0

config BOARD_ARTINCHIP_D11X_DEMO68_NOPSRAM_XIP
	select SOC_D11X
```

## boards/artinchip/d11x_demo68_nopsram_xip/artinchip_d11x_demo68_nopsram_xip_defconfig
```kconfig
# SPDX-FileCopyrightText: Copyright (c) 2026 UltraSemi Technology Development Co., Ltd.
# SPDX-License-Identifier: Apache-2.0

CONFIG_SERIAL=y
CONFIG_CONSOLE=y
CONFIG_UART_CONSOLE=y
CONFIG_SHELL=y
CONFIG_SHELL_BACKEND_SERIAL=y
CONFIG_SHELL_BACKEND_SERIAL_INTERRUPT_DRIVEN=n
CONFIG_SHELL_BACKEND_SERIAL_API_POLLING=y

# Vendor XIP payload follows the 256-byte AIC header.
CONFIG_XIP=y
CONFIG_USE_DT_CODE_PARTITION=y
```

## boards/artinchip/d11x_demo68_nopsram_xip/board.yml
```yaml
# SPDX-FileCopyrightText: Copyright (c) 2026 UltraSemi Technology Development Co., Ltd.
# SPDX-License-Identifier: Apache-2.0

board:
  name: artinchip_d11x_demo68_nopsram_xip
  full_name: ArtInChip D11X demo68-nopsram-xip
  vendor: artinchip
  socs:
    - name: d11x
```

## boards/artinchip/d126_demo124_nor/Kconfig.artinchip_d126_demo124_nor
```kconfig
# SPDX-FileCopyrightText: Copyright (c) 2026 UltraSemi Technology Development Co., Ltd.
# SPDX-License-Identifier: Apache-2.0

config BOARD_ARTINCHIP_D126_DEMO124_NOR
	select SOC_D126FCV
```

## boards/artinchip/d126_demo124_nor/board.yml
```yaml
# SPDX-FileCopyrightText: Copyright (c) 2026 UltraSemi Technology Development Co., Ltd.
# SPDX-License-Identifier: Apache-2.0

board:
  name: artinchip_d126_demo124_nor
  full_name: ArtInChip D126 Demo124 NOR
  vendor: artinchip
  socs:
    - name: d126fcv
```

## boards/artinchip/d12p_demo132_nor/Kconfig.artinchip_d12p_demo132_nor
```kconfig
# SPDX-FileCopyrightText: Copyright (c) 2026 UltraSemi Technology Development Co., Ltd.
# SPDX-License-Identifier: Apache-2.0

config BOARD_ARTINCHIP_D12P_DEMO132_NOR
	select SOC_D12P
```

## boards/artinchip/d12p_demo132_nor/board.yml
```yaml
# SPDX-FileCopyrightText: Copyright (c) 2026 UltraSemi Technology Development Co., Ltd.
# SPDX-License-Identifier: Apache-2.0

board:
  name: artinchip_d12p_demo132_nor
  full_name: ArtInChip D12P demo132-nor
  vendor: artinchip
  socs:
    - name: d12p
```

## boards/artinchip/d12p_demo88_nor/artinchip_d12p_demo88_nor_defconfig
```kconfig
# SPDX-FileCopyrightText: Copyright (c) 2026 UltraSemi Technology Development Co., Ltd.
# SPDX-License-Identifier: Apache-2.0

CONFIG_CONSOLE=y
CONFIG_SERIAL=y
CONFIG_UART_CONSOLE=y
CONFIG_CLOCK_CONTROL=y
CONFIG_RESET=y
CONFIG_PINCTRL=y
CONFIG_UART_ARTINCHIP_D12P_NATIVE=y
```

## boards/artinchip/d12p_demo88_nor/board.yml
```yaml
# SPDX-FileCopyrightText: Copyright (c) 2026 UltraSemi Technology Development Co., Ltd.
# SPDX-License-Identifier: Apache-2.0

board:
  name: artinchip_d12p_demo88_nor
  full_name: ArtInChip D12p Demo88 NOR
  vendor: artinchip
  socs:
    - name: d125ccr
```

## boards/artinchip/d12p_usbdisp_demo88_nor/Kconfig.artinchip_d12p_usbdisp_demo88_nor
```kconfig
# SPDX-FileCopyrightText: Copyright (c) 2026 UltraSemi Technology Development Co., Ltd.
# SPDX-License-Identifier: Apache-2.0

config BOARD_ARTINCHIP_D12P_USBDISP_DEMO88_NOR
	select SOC_D125CCR
```

## boards/artinchip/d12p_usbdisp_demo88_nor/artinchip_d12p_usbdisp_demo88_nor_defconfig
```kconfig
# SPDX-FileCopyrightText: Copyright (c) 2026 UltraSemi Technology Development Co., Ltd.
# SPDX-License-Identifier: Apache-2.0

CONFIG_CONSOLE=y
CONFIG_SERIAL=y
CONFIG_SHELL=y
CONFIG_SHELL_BACKEND_SERIAL=y
CONFIG_UART_CONSOLE=y
```

## boards/artinchip/d12p_usbdisp_demo88_nor/board.yml
```yaml
# SPDX-FileCopyrightText: Copyright (c) 2026 UltraSemi Technology Development Co., Ltd.
# SPDX-License-Identifier: Apache-2.0

board:
  name: artinchip_d12p_usbdisp_demo88_nor
  full_name: ArtInChip D12p USB Display Demo88 NOR
  vendor: artinchip
  socs:
    - name: d125ccr
```

## boards/artinchip/d12x_demo68_nand/Kconfig.artinchip_d12x_demo68_nand
```kconfig
# SPDX-FileCopyrightText: Copyright (c) 2026 UltraSemi Technology Development Co., Ltd.
# SPDX-License-Identifier: Apache-2.0

config BOARD_ARTINCHIP_D12X_DEMO68_NAND
	select SOC_D12X
```

## boards/artinchip/d12x_demo68_nand/board.yml
```yaml
# SPDX-FileCopyrightText: Copyright (c) 2026 UltraSemi Technology Development Co., Ltd.
# SPDX-License-Identifier: Apache-2.0

board:
  name: artinchip_d12x_demo68_nand
  full_name: ArtInChip D12X demo68-nand
  vendor: artinchip
  socs:
    - name: d12x
```

## boards/artinchip/d12x_hmi_nor/Kconfig.artinchip_d12x_hmi_nor
```kconfig
# SPDX-FileCopyrightText: Copyright (c) 2026 UltraSemi Technology Development Co., Ltd.
# SPDX-License-Identifier: Apache-2.0

config BOARD_ARTINCHIP_D12X_HMI_NOR
	select SOC_D12X
```

## boards/artinchip/d12x_hmi_nor/board.yml
```yaml
# SPDX-FileCopyrightText: Copyright (c) 2026 UltraSemi Technology Development Co., Ltd.
# SPDX-License-Identifier: Apache-2.0

board:
  name: artinchip_d12x_hmi_nor
  full_name: ArtInChip D12X hmi-nor
  vendor: artinchip
  socs:
    - name: d12x
```

## boards/artinchip/d13x_demo68_nor/Kconfig.artinchip_d13x_demo68_nor
```kconfig
# SPDX-FileCopyrightText: Copyright (c) 2026 UltraSemi Technology Development Co., Ltd.
# SPDX-License-Identifier: Apache-2.0

config BOARD_ARTINCHIP_D13X_DEMO68_NOR
	select SOC_D13X
```

## boards/artinchip/d13x_demo68_nor/board.yml
```yaml
# SPDX-FileCopyrightText: Copyright (c) 2026 UltraSemi Technology Development Co., Ltd.
# SPDX-License-Identifier: Apache-2.0

board:
  name: artinchip_d13x_demo68_nor
  full_name: ArtInChip D13X demo68-nor
  vendor: artinchip
  socs:
    - name: d13x
```

## boards/artinchip/d13x_demo88_nand/board.yml
```yaml
# SPDX-FileCopyrightText: Copyright (c) 2026 UltraSemi Technology Development Co., Ltd.
# SPDX-License-Identifier: Apache-2.0

board:
  name: artinchip_d13x_demo88_nand
  full_name: ArtInChip D13X demo88-nand
  vendor: artinchip
  socs:
    - name: d13x
```

## boards/artinchip/d13x_demo88_nor/Kconfig.artinchip_d13x_demo88_nor
```kconfig
# SPDX-FileCopyrightText: Copyright (c) 2026 UltraSemi Technology Development Co., Ltd.
# SPDX-License-Identifier: Apache-2.0

config BOARD_ARTINCHIP_D13X_DEMO88_NOR
	select SOC_D13X
	select SOC_RESET_HOOK if MCUBOOT
```

## boards/artinchip/d13x_demo88_nor/artinchip_d13x_demo88_nor_defconfig
```kconfig
# SPDX-FileCopyrightText: Copyright (c) 2026 UltraSemi Technology Development Co., Ltd.
# SPDX-License-Identifier: Apache-2.0

CONFIG_CONSOLE=y
CONFIG_SERIAL=y
CONFIG_UART_CONSOLE=y
CONFIG_PINCTRL=y
```

## boards/artinchip/d13x_hspi100_nor/board.yml
```yaml
# SPDX-FileCopyrightText: Copyright (c) 2026 UltraSemi Technology Development Co., Ltd.
# SPDX-License-Identifier: Apache-2.0

board:
  name: artinchip_d13x_hspi100_nor
  full_name: ArtInChip D13X hspi100-nor
  vendor: artinchip
  socs:
    - name: d13x
```

## boards/artinchip/d21x_d215_demo88_nand/Kconfig.artinchip_d21x_d215_demo88_nand
```kconfig
# SPDX-FileCopyrightText: Copyright (c) 2026 UltraSemi Technology Development Co., Ltd.
# SPDX-License-Identifier: Apache-2.0

config BOARD_ARTINCHIP_D21X_D215_DEMO88_NAND
	select SOC_D21X
```

## boards/artinchip/d21x_d215_demo88_nand/board.yml
```yaml
# SPDX-FileCopyrightText: Copyright (c) 2026 UltraSemi Technology Development Co., Ltd.
# SPDX-License-Identifier: Apache-2.0

board:
  name: artinchip_d21x_d215_demo88_nand
  full_name: ArtInChip D21X d215-demo88-nand
  vendor: artinchip
  socs:
    - name: d21x
```

## boards/artinchip/d21x_demo128_nand/Kconfig.artinchip_d21x_demo128_nand
```kconfig
# SPDX-FileCopyrightText: Copyright (c) 2026 UltraSemi Technology Development Co., Ltd.
# SPDX-License-Identifier: Apache-2.0

config BOARD_ARTINCHIP_D21X_DEMO128_NAND
	select SOC_D21X
	select SOC_RESET_HOOK
```
