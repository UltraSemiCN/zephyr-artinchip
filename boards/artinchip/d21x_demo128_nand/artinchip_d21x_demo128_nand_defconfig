## boards/artinchip/d21x_demo128_nand/artinchip_d21x_demo128_nand_defconfig
```kconfig
# SPDX-FileCopyrightText: Copyright (c) 2026 UltraSemi Technology Development Co., Ltd.
# SPDX-License-Identifier: Apache-2.0

CONFIG_CLOCK_CONTROL=y
CONFIG_RESET=y
CONFIG_PINCTRL=y
CONFIG_SERIAL=y
CONFIG_CONSOLE=y
CONFIG_UART_CONSOLE=y
CONFIG_SHELL=y
CONFIG_SHELL_BACKEND_SERIAL=y
CONFIG_SHELL_BACKEND_SERIAL_INTERRUPT_DRIVEN=n
```

## boards/artinchip/d21x_demo128_nand/board.yml
```yaml
# SPDX-FileCopyrightText: Copyright (c) 2026 UltraSemi Technology Development Co., Ltd.
# SPDX-License-Identifier: Apache-2.0

board:
  name: artinchip_d21x_demo128_nand
  full_name: ArtInChip D21X demo128-nand
  vendor: artinchip
  socs:
    - name: d21x
```

## boards/artinchip/d21x_demo88_mmc/board.yml
```yaml
# SPDX-FileCopyrightText: Copyright (c) 2026 UltraSemi Technology Development Co., Ltd.
# SPDX-License-Identifier: Apache-2.0

board:
  name: artinchip_d21x_demo88_mmc
  full_name: ArtInChip D21X demo88-mmc
  vendor: artinchip
  socs:
    - name: d21x
```

## boards/artinchip/g72x_demo48_nor/Kconfig.artinchip_g72x_demo48_nor
```kconfig
# SPDX-FileCopyrightText: Copyright (c) 2026 UltraSemi Technology Development Co., Ltd.
# SPDX-License-Identifier: Apache-2.0

config BOARD_ARTINCHIP_G72X_DEMO48_NOR
	select SOC_G72X
```

## boards/artinchip/g72x_demo48_nor/board.yml
```yaml
# SPDX-FileCopyrightText: Copyright (c) 2026 UltraSemi Technology Development Co., Ltd.
# SPDX-License-Identifier: Apache-2.0

board:
  name: artinchip_g72x_demo48_nor
  full_name: ArtInChip G72X demo48-nor
  vendor: artinchip
  socs:
    - name: g72x
```

## boards/artinchip/g73x_demo100_nor/Kconfig.artinchip_g73x_demo100_nor
```kconfig
# SPDX-FileCopyrightText: Copyright (c) 2026 UltraSemi Technology Development Co., Ltd.
# SPDX-License-Identifier: Apache-2.0

config BOARD_ARTINCHIP_G73X_DEMO100_NOR
	select SOC_G73X
```

## boards/artinchip/g73x_demo100_nor/board.yml
```yaml
# SPDX-FileCopyrightText: Copyright (c) 2026 UltraSemi Technology Development Co., Ltd.
# SPDX-License-Identifier: Apache-2.0

board:
  name: artinchip_g73x_demo100_nor
  full_name: ArtInChip G73X demo100-nor
  vendor: artinchip
  socs:
    - name: g73x
```

## boards/artinchip/g73x_demo68_nor/Kconfig.artinchip_g73x_demo68_nor
```kconfig
# SPDX-FileCopyrightText: Copyright (c) 2026 UltraSemi Technology Development Co., Ltd.
# SPDX-License-Identifier: Apache-2.0

config BOARD_ARTINCHIP_G73X_DEMO68_NOR
	select SOC_G73X
```

## boards/artinchip/g73x_demo68_nor/board.yml
```yaml
# SPDX-FileCopyrightText: Copyright (c) 2026 UltraSemi Technology Development Co., Ltd.
# SPDX-License-Identifier: Apache-2.0

board:
  name: artinchip_g73x_demo68_nor
  full_name: ArtInChip G73X demo68-nor
  vendor: artinchip
  socs:
    - name: g73x
```

## boards/artinchip/g73x_scan/Kconfig.artinchip_g73x_scan
```kconfig
# SPDX-FileCopyrightText: Copyright (c) 2026 UltraSemi Technology Development Co., Ltd.
# SPDX-License-Identifier: Apache-2.0

config BOARD_ARTINCHIP_G73X_SCAN
	select SOC_G73X
```

## boards/artinchip/g73x_scan/board.yml
```yaml
# SPDX-FileCopyrightText: Copyright (c) 2026 UltraSemi Technology Development Co., Ltd.
# SPDX-License-Identifier: Apache-2.0

board:
  name: artinchip_g73x_scan
  full_name: ArtInChip G73X scan
  vendor: artinchip
  socs:
    - name: g73x
```

## boards/artinchip/kunlunpi_d133cbs/Kconfig.artinchip_kunlunpi_d133cbs
```kconfig
# SPDX-FileCopyrightText: Copyright (c) 2026 UltraSemi Technology Development Co., Ltd.
# SPDX-License-Identifier: Apache-2.0

config BOARD_ARTINCHIP_KUNLUNPI_D133CBS
	select SOC_D133CBS
```

## boards/artinchip/kunlunpi_d133cbs/artinchip_kunlunpi_d133cbs_defconfig
```kconfig
# SPDX-FileCopyrightText: Copyright (c) 2026 UltraSemi Technology Development Co., Ltd.
# SPDX-License-Identifier: Apache-2.0

CONFIG_CONSOLE=y
CONFIG_GPIO=y
CONFIG_I2C=y
CONFIG_INPUT=y
CONFIG_INPUT_ADC_KEYS=y
CONFIG_INPUT_GT911=y
CONFIG_INPUT_GT911_INTERRUPT=y
CONFIG_ADC=y
CONFIG_ADC_GPAI_ARTINCHIP=y
CONFIG_PINCTRL=y
CONFIG_MEMC=y
CONFIG_PWM=y
CONFIG_SERIAL=y
CONFIG_SYSCON=y
CONFIG_RTC=y
CONFIG_RTC_ALARM=y
CONFIG_SENSOR=y
CONFIG_SHELL=y
CONFIG_SHELL_BACKEND_SERIAL=y
CONFIG_UART_CONSOLE=y
```

## boards/artinchip/kunlunpi_d133cbs/board.yml
```yaml
# SPDX-FileCopyrightText: Copyright (c) 2026 UltraSemi Technology Development Co., Ltd.
# SPDX-License-Identifier: Apache-2.0

board:
  name: artinchip_kunlunpi_d133cbs
  full_name: ArtInChip Kunlun Pi D133CBS
  vendor: artinchip
  socs:
    - name: d133cbs
```

## boards/ultrasemi/d12p_usbdisp_demo88_nor_5_5/Kconfig.ultrasemi_d12p_usbdisp_demo88_nor_5_5
```kconfig
# SPDX-FileCopyrightText: Copyright (c) 2026 UltraSemi Technology Development Co., Ltd.
# SPDX-License-Identifier: Apache-2.0

config BOARD_ULTRASEMI_D12P_USBDISP_DEMO88_NOR_5_5
	select SOC_D125CCV
	select SOC_RESET_HOOK if MCUBOOT
```

## boards/ultrasemi/d12p_usbdisp_demo88_nor_5_5/board.yml
```yaml
# SPDX-FileCopyrightText: Copyright (c) 2026 UltraSemi Technology Development Co., Ltd.
# SPDX-License-Identifier: Apache-2.0

board:
  name: ultrasemi_d12p_usbdisp_demo88_nor_5_5
  full_name: UltraSemi D12P USB Display Demo88 NOR 5.5-inch (720x1280 MIPI)
  vendor: ultrasemi
  socs:
    - name: d125ccv
```

## boards/ultrasemi/d12p_usbdisp_demo88_nor_5_5/ultrasemi_d12p_usbdisp_demo88_nor_5_5_defconfig
```kconfig
# SPDX-FileCopyrightText: Copyright (c) 2026 UltraSemi Technology Development Co., Ltd.
# SPDX-License-Identifier: Apache-2.0

CONFIG_CONSOLE=y
CONFIG_CLOCK_CONTROL=y
CONFIG_GPIO=y
CONFIG_I2C=y
CONFIG_INPUT=y
CONFIG_PINCTRL=y
CONFIG_RESET=y
CONFIG_SERIAL=y
CONFIG_UART_CONSOLE=y

CONFIG_UART_ARTINCHIP_D12P_NATIVE=y
```

## drivers/adc/Kconfig.gpai_artinchip
```kconfig
# SPDX-FileCopyrightText: Copyright (c) 2026 UltraSemi Technology Development Co., Ltd.
# SPDX-License-Identifier: Apache-2.0

config ADC_GPAI_ARTINCHIP
	bool "ArtInChip general-purpose ADC"
	default y
	depends on DT_HAS_ARTINCHIP_D13X_GPAI_ENABLED
	depends on CLOCK_CONTROL && RESET
	help
	  Enable synchronous single-shot sampling on the ArtInChip GPAI controller.
```

## drivers/adc/Kconfig.psadc_artinchip
```kconfig
# SPDX-FileCopyrightText: Copyright (c) 2026 UltraSemi Technology Development Co., Ltd.
# SPDX-License-Identifier: Apache-2.0

config ADC_PSADC_ARTINCHIP
	bool "ArtInChip precision sampling ADC"
	default y
	depends on DT_HAS_ARTINCHIP_D13X_PSADC_ENABLED
	depends on CLOCK_CONTROL && RESET
	help
	  Enable synchronous software-triggered queue sampling on the ArtInChip
	  precision sampling ADC.
```

## drivers/audio/Kconfig.artinchip
```kconfig
# SPDX-FileCopyrightText: Copyright (c) 2026 UltraSemi Technology Development Co., Ltd.
# SPDX-License-Identifier: Apache-2.0

config AUDIO_CODEC_ARTINCHIP
	bool "ArtInChip integrated audio codec"
	default y
	depends on DT_HAS_ARTINCHIP_D13X_CODEC_ENABLED
	select RESET
	help
	  Enable playback control for the integrated ArtInChip audio codec.
	  DMA-backed audio data transfer is not implemented yet.
```

## drivers/can/Kconfig.artinchip
```kconfig
# SPDX-FileCopyrightText: Copyright (c) 2026 UltraSemi Technology Development Co., Ltd.
# SPDX-License-Identifier: Apache-2.0

config CAN_ARTINCHIP
	bool "ArtInChip CAN controller"
	default y
	depends on DT_HAS_ARTINCHIP_D13X_CAN_ENABLED
	depends on CLOCK_CONTROL && RESET
	select CAN_SJA1000
	help
	  Enable the SJA1000-compatible CAN controller on ArtInChip SoCs.
```

## drivers/clock_control/Kconfig.artinchip
```kconfig
# SPDX-FileCopyrightText: Copyright (c) 2026 UltraSemi Technology Development Co., Ltd.
# SPDX-License-Identifier: Apache-2.0

config CLOCK_CONTROL_ARTINCHIP
	bool "ArtInChip clock control"
	default y
	depends on DT_HAS_ARTINCHIP_D13X_CCTL_ENABLED || DT_HAS_ARTINCHIP_D12P_CCTL_ENABLED
	help
	  Enable clock gate and peripheral clock rate support for ArtInChip
	  ArtInChip SoCs.
```

## drivers/display/Kconfig.artinchip
```kconfig
# SPDX-FileCopyrightText: Copyright (c) 2026 UltraSemi Technology Development Co., Ltd.
# SPDX-License-Identifier: Apache-2.0

config DISPLAY_ARTINCHIP_DE
	bool "ArtInChip display engine driver"
	default y
	depends on DT_HAS_ARTINCHIP_D13X_DE_ENABLED
	depends on CLOCK_CONTROL
	depends on RESET
	help
	  Enable the ArtInChip display engine framebuffer bridge.

config DISPLAY_ARTINCHIP_DE_SHELL
	bool "ArtInChip display engine shell commands"
	depends on DISPLAY_ARTINCHIP_DE
	depends on SHELL
	help
	  Enable diagnostic shell commands for the ArtInChip display engine.

config DISPLAY_ARTINCHIP_RGB
	bool "ArtInChip RGB output driver"
	default y
	depends on DT_HAS_ARTINCHIP_D13X_RGB_ENABLED
	depends on CLOCK_CONTROL
	depends on RESET
	select PINCTRL
	help
	  Enable the ArtInChip RGB/LCD output block used between DE timing
	  output and parallel RGB panels.

config DISPLAY_ARTINCHIP_RGB_SHELL
	bool "ArtInChip RGB output shell commands"
	depends on DISPLAY_ARTINCHIP_RGB
	depends on SHELL
	help
	  Enable diagnostic shell commands for the ArtInChip RGB output block.

config EK79007AD
	bool "Fitipower EK79007AD MIPI-DSI panel"
	default y
	depends on DT_HAS_FITIPOWER_EK79007AD_ENABLED
	depends on MIPI_DSI
	help
	  Enable the 7-inch 1024x600 MIPI-DSI panel used by ArtInChip
	  D12p reference boards.

if EK79007AD

config DISPLAY_EK79007AD_INIT_PRIORITY
	int "EK79007AD init priority"
	default 86
	help
	  EK79007AD display panel initialization priority.

config EK79007AD_DEFER_PANEL_INIT
	bool "Defer EK79007AD DCS init until DSI display enable sequence"
	default y
	depends on MIPI_DSI_ARTINCHIP_SHELL || MIPI_DSI_ARTINCHIP_AUTO_ENABLE_SEQUENCE
	help
	  When enabled, boot only configures panel GPIOs. The DSI display
	  enable sequence attaches the panel, sends DCS init in command mode,
	  and switches to video mode.

endif # EK79007AD

config DISPLAY_ARTINCHIP_POS_PANEL
	bool "ArtInChip 720x1280 multi-vendor POS MIPI-DSI panel"
	default y
	depends on DT_HAS_ARTINCHIP_POS_PANEL_ENABLED
	depends on MIPI_DSI
	help
	  Enable the portrait POS panel family. The driver reads DCS register
	  0xDA and selects the ID 0x17, 0x57, 0x11, or 0x1313 init sequence.

if DISPLAY_ARTINCHIP_POS_PANEL

config DISPLAY_ARTINCHIP_POS_PANEL_INIT_PRIORITY
	int "POS panel init priority"
	default 86

config ARTINCHIP_POS_PANEL_DEFER_PANEL_INIT
	bool "Defer POS panel DCS init until the DSI enable sequence"
	default y
	depends on DISPLAY_ARTINCHIP_POS_PIPELINE

endif # DISPLAY_ARTINCHIP_POS_PANEL

config DISPLAY_ARTINCHIP_POS_PIPELINE
	bool "ArtInChip POS DSI display pipeline"
	default y
	depends on DT_HAS_ARTINCHIP_POS_DISPLAY_PIPELINE_ENABLED
	depends on DISPLAY_ARTINCHIP_DE
	depends on DISPLAY_ARTINCHIP_POS_PANEL
	depends on MIPI_DSI_ARTINCHIP
	help
	  Enable the board-level coordinator which attaches the POS panel to the
	  generic DSI host, prepares the PHY, initializes the panel, starts the
	  display engine, and enables the panel backlight.

if DISPLAY_ARTINCHIP_POS_PIPELINE

config DISPLAY_ARTINCHIP_POS_PIPELINE_INIT_PRIORITY
	int "POS display pipeline init priority"
	default 90

config DISPLAY_ARTINCHIP_POS_PIPELINE_TEST_PATTERN
	bool "Show RGB color bars before the application draws"
	help
	  Fill the DE framebuffer with persistent RGB565 color bars. This is useful
	  for panel/DSI diagnostics when the application does not refresh LVGL.

endif # DISPLAY_ARTINCHIP_POS_PIPELINE

config DISPLAY_ARTINCHIP_LVDS
	bool "ArtInChip D13x single-link LVDS output"
	default y
	depends on DT_HAS_ARTINCHIP_D13X_LVDS_ENABLED
	depends on DISPLAY_ARTINCHIP_DE
	depends on CLOCK_CONTROL && RESET && GPIO
	select PINCTRL
	help
	  Enable LVDS link 0, the display engine and panel enable GPIO.
	  Supports VESA 24-bit and JEIDA 18/24-bit panels.

config DISPLAY_ARTINCHIP_LVDS_INIT_PRIORITY
	int "ArtInChip LVDS initialization priority"
	default 90
	depends on DISPLAY_ARTINCHIP_LVDS
	help
	  Must run after the display engine and before LVGL initialization.
```

## drivers/dma/Kconfig.artinchip
```kconfig
# SPDX-FileCopyrightText: Copyright (c) 2026 UltraSemi Technology Development Co., Ltd.
# SPDX-License-Identifier: Apache-2.0

config DMA_ARTINCHIP
	bool "ArtInChip DMA driver"
	default y
	depends on DT_HAS_ARTINCHIP_D13X_DMA_ENABLED
	help
	  Enable the ArtInChip DMA controller driver used by UART and
	  other peripherals.
```

## drivers/ethernet/mdio/Kconfig.artinchip
```kconfig
# SPDX-FileCopyrightText: Copyright (c) 2026 UltraSemi Technology Development Co., Ltd.
# SPDX-License-Identifier: Apache-2.0

config MDIO_ARTINCHIP
	bool "ArtInChip GMAC MDIO controller"
	default y
	depends on DT_HAS_ARTINCHIP_D13X_MDIO_ENABLED
	select RESET
	help
	  Enable Clause 22 MDIO access through the ArtInChip GMAC.
```
