## drivers/spi/Kconfig.artinchip
```kconfig
# SPDX-FileCopyrightText: Copyright (c) 2026 UltraSemi Technology Development Co., Ltd.
# SPDX-License-Identifier: Apache-2.0

config SPI_ARTINCHIP
	bool "ArtInChip QSPI controller"
	default y
	depends on DT_HAS_ARTINCHIP_D13X_QSPI_ENABLED
	select PINCTRL
	select RESET
	help
	  Enable polling-mode master support for the QSPI controllers found
	  on ArtInChip SoCs. The initial implementation supports standard
	  single-line SPI transfers with 8-bit words.
```

## drivers/usb/udc/Kconfig.aic
```kconfig
# SPDX-FileCopyrightText: Copyright (c) 2026 UltraSemi Technology Development Co., Ltd.
# SPDX-License-Identifier: Apache-2.0

config UDC_AIC
	bool "ArtInChip USB device controller driver"
	default y
	depends on DT_HAS_ARTINCHIP_D12P_USBD_ENABLED
	select UDC_DRIVER_HAS_HIGH_SPEED_SUPPORT
	help
	  USB device controller driver for the ArtInChip USB 2.0 device core
	  (Synopsys DWC2-derived device-only core with legacy register layout).
	  Operates in Completer/PIO (slave) transfer mode.

config UDC_AIC_STACK_SIZE
	int "ArtInChip UDC driver internal thread stack size"
	depends on UDC_AIC
	default 1024
	help
	  ArtInChip UDC driver internal thread stack size.

config UDC_AIC_THREAD_PRIORITY
	int "ArtInChip UDC driver thread priority"
	depends on UDC_AIC
	default 8
	help
	  ArtInChip UDC driver internal thread priority.
```

## drivers/video/Kconfig.artinchip
```kconfig
# SPDX-FileCopyrightText: Copyright (c) 2026 UltraSemi Technology Development Co., Ltd.
# SPDX-License-Identifier: Apache-2.0

config VIDEO_ARTINCHIP_DVP
	bool "ArtInChip DVP receiver"
	default y
	depends on DT_HAS_ARTINCHIP_D12P_DVP_ENABLED || DT_HAS_ARTINCHIP_D13X_DVP_ENABLED
	depends on CLOCK_CONTROL
	depends on RESET
	select PINCTRL
	help
	  Enable the ArtInChip digital video port receiver for v1 and v2
	  controller variants.

config VIDEO_ARTINCHIP_DVP_SHELL
	bool "ArtInChip DVP shell commands"
	depends on VIDEO_ARTINCHIP_DVP
	depends on SHELL
	help
	  Enable diagnostic shell commands for the ArtInChip DVP receiver.
```

## drivers/watchdog/Kconfig.artinchip
```kconfig
# SPDX-FileCopyrightText: Copyright (c) 2026 UltraSemi Technology Development Co., Ltd.
# SPDX-License-Identifier: Apache-2.0

config WDT_ARTINCHIP
	bool "ArtInChip watchdog"
	default y
	depends on DT_HAS_ARTINCHIP_D13X_WDT_ENABLED
	depends on CLOCK_CONTROL && RESET
	help
	  Enable the watchdog driver for ArtInChip SoCs.
```

## dts/bindings/adc/artinchip,d13x-gpai.yaml
```yaml
# SPDX-FileCopyrightText: Copyright (c) 2026 UltraSemi Technology Development Co., Ltd.
# SPDX-License-Identifier: Apache-2.0

description: ArtInChip D13x general-purpose ADC

compatible: "artinchip,d13x-gpai"

include:
  - adc-controller.yaml
  - pinctrl-device.yaml
  - reset-device.yaml

properties:
  reg:
    required: true

  clocks:
    required: true

  artinchip,adcim:
    type: phandle
    required: true
    description: Shared ADC interface manager used for calibration

  channels:
    type: int
    required: true
    description: Number of implemented GPAI channels

  vref-mv:
    type: int
    default: 3000
    description: ADC reference voltage in millivolts

  "#io-channel-cells":
    const: 1

io-channel-cells:
  - input
```

## dts/bindings/adc/artinchip,d13x-psadc.yaml
```yaml
# SPDX-FileCopyrightText: Copyright (c) 2026 UltraSemi Technology Development Co., Ltd.
# SPDX-License-Identifier: Apache-2.0

description: ArtInChip D13x precision sampling ADC

compatible: "artinchip,d13x-psadc"

include:
  - adc-controller.yaml
  - reset-device.yaml

properties:
  reg:
    required: true

  clocks:
    required: true

  artinchip,adcim:
    type: phandle
    required: true
    description: Shared ADC interface manager used for calibration

  channels:
    type: int
    required: true
    description: Number of implemented PSADC channels

  vref-mv:
    type: int
    default: 3000
    description: ADC reference voltage in millivolts

  "#io-channel-cells":
    const: 1

io-channel-cells:
  - input
```

## dts/bindings/audio/artinchip,d13x-codec.yaml
```yaml
# SPDX-FileCopyrightText: Copyright (c) 2026 UltraSemi Technology Development Co., Ltd.
# SPDX-License-Identifier: Apache-2.0

description: ArtInChip D13x integrated audio codec

compatible: "artinchip,d13x-codec"

include: [base.yaml, reset-device.yaml]

properties:
  reg:
    required: true

  clocks:
    required: true

  interrupts:
    required: true
```

## dts/bindings/can/artinchip,d13x-can.yaml
```yaml
# SPDX-FileCopyrightText: Copyright (c) 2026 UltraSemi Technology Development Co., Ltd.
# SPDX-License-Identifier: Apache-2.0

description: ArtInChip D13x SJA1000-compatible CAN controller

compatible: "artinchip,d13x-can"

include:
  - can-controller.yaml
  - reset-device.yaml

properties:
  reg:
    required: true

  clocks:
    required: true

  interrupts:
    required: true
```

## dts/bindings/clock/artinchip,d12p-cctl.yaml
```yaml
# SPDX-FileCopyrightText: Copyright (c) 2026 UltraSemi Technology Development Co., Ltd.
# SPDX-License-Identifier: Apache-2.0

description: ArtInChip D12P clock controller

compatible: "artinchip,d12p-cctl"

include: artinchip,d13x-cctl.yaml

properties:
  artinchip,qspi-clock-frequency:
    description: |
      Maximum QSPI controller input clock frequency in Hz. The driver
      selects a PLL_FRA0 divider that does not exceed this rate.
```

## dts/bindings/clock/artinchip,d13x-cctl.yaml
```yaml
# SPDX-FileCopyrightText: Copyright (c) 2026 UltraSemi Technology Development Co., Ltd.
# SPDX-License-Identifier: Apache-2.0

title: ArtInChip D13x Clock Controller

description: Controls D13x peripheral clock gates and reports divided clock rates

compatible: "artinchip,d13x-cctl"

include: [clock-controller.yaml, base.yaml]

properties:
  "#clock-cells":
    const: 1

  clock-frequency:
    type: int
    required: true
    description: Parent PLL_INT1 clock frequency in Hz

  artinchip,uart0-clock-frequency:
    type: int
    required: true
    description: UART0 target clock frequency in Hz

  artinchip,qspi-clock-frequency:
    type: int
    description: |
      QSPI controller input clock frequency in Hz. The initial clock driver
      preserves the bootloader-programmed PLL_FRA0 divider and uses this
      value when reporting the QSPI clock rate.

  artinchip,apb0-clock-frequency:
    type: int
    description: APB0 peripheral clock frequency in Hz

  artinchip,apb1-clock-frequency:
    type: int
    description: APB1 peripheral clock frequency in Hz

  artinchip,pwm-clock-frequency:
    type: int
    description: PWM controller input clock frequency in Hz

  artinchip,xspi-clock-frequency:
    type: int
    description: Bootloader-configured XSPI controller input clock frequency in Hz

  artinchip,display-sclk-clock-frequency:
    type: int
    description: |
      Display serial clock frequency in Hz. D12P uses this for its display
      outputs. D13x single-link LVDS requires seven times the pixel clock.

  artinchip,display-pixclk-clock-frequency:
    type: int
    description: |
      Display pixel clock frequency in Hz for the display engine timing path.
      Supported by D12P display outputs and D13x single-link LVDS.

clock-cells:
  - clkid
```

## dts/bindings/clock/artinchip,d21x-cctl.yaml
```yaml
# SPDX-FileCopyrightText: Copyright (c) 2026 UltraSemi
# SPDX-License-Identifier: Apache-2.0

description: ArtInChip D21x clock controller (UART, GPIO and QSPI bring-up)
compatible: "artinchip,d21x-cctl"
include: artinchip,d13x-cctl.yaml
```

## dts/bindings/cpu/xuantie,c906.yaml
```yaml
# Copyright (c) 2026 UltraSemi
# SPDX-License-Identifier: Apache-2.0

description: XuanTie C906 Core CPU

compatible: "xuantie,c906"

include: riscv-common.yaml
```

## dts/bindings/crypto/artinchip,d13x-ce.yaml
```yaml
# SPDX-FileCopyrightText: Copyright (c) 2026 UltraSemi Technology Development Co., Ltd.
# SPDX-License-Identifier: Apache-2.0

description: ArtInChip D13x crypto engine controller

compatible: "artinchip,d13x-ce"

include: [base.yaml, reset-device.yaml]

properties:
  reg:
    required: true

  clocks:
    required: true

  interrupts:
    required: true
```

## dts/bindings/display/artinchip,d12p-de.yaml
```yaml
description: ArtInChip D12P display engine

compatible: "artinchip,d12p-de"

include: artinchip,d13x-de.yaml
```

## dts/bindings/display/artinchip,d12p-rgb.yaml
```yaml
# SPDX-FileCopyrightText: Copyright (c) 2026 UltraSemi Technology Development Co., Ltd.
# SPDX-License-Identifier: Apache-2.0

description: ArtInChip D12P RGB display output

compatible: "artinchip,d12p-rgb"

include: artinchip,d13x-rgb.yaml
```

## dts/bindings/display/artinchip,d13x-de.yaml
```yaml
# SPDX-FileCopyrightText: Copyright (c) 2026 UltraSemi Technology Development Co., Ltd.
# SPDX-License-Identifier: Apache-2.0

description: ArtInChip D13x display engine

compatible: "artinchip,d13x-de"

include: [display-controller.yaml, reset-device.yaml]

properties:
  reg:
    required: true

  clocks:
    required: true

  interrupts:
    required: true

  width:
    type: int
    required: true
    description: Active framebuffer width in pixels

  height:
    type: int
    required: true
    description: Active framebuffer height in pixels

  hfront-porch:
    type: int
    required: true

  hback-porch:
    type: int
    required: true

  hsync-len:
    type: int
    required: true

  vfront-porch:
    type: int
    required: true

  vback-porch:
    type: int
    required: true

  vsync-len:
    type: int
    required: true

  hsync-active:
    type: boolean
    description: HSYNC active-high polarity

  vsync-active:
    type: boolean
    description: VSYNC active-high polarity

  framebuffer-address:
    type: int
    required: true
    description:
      Physical address of a linear framebuffer. The initial driver uses this
      as a software-visible backing store before native DE layer scanout is
      fully configured.

  framebuffer-size:
    type: int
    required: true
    description: Framebuffer size in bytes

  artinchip,manual-start:
    type: boolean
    description:
      Register the display device without touching DE registers during boot.
      This is useful while validating new boards where clock, reset, power, or
      memory ownership is not yet fully proven. The hardware can be started
      later through the ArtInChip DE shell diagnostics.
```

## dts/bindings/display/artinchip,d13x-lvds.yaml
```yaml
# SPDX-FileCopyrightText: Copyright (c) 2026 UltraSemi
# SPDX-License-Identifier: Apache-2.0

description: ArtInChip D13x single-link LVDS transmitter (link 0)

compatible: "artinchip,d13x-lvds"

include: [base.yaml, reset-device.yaml, pinctrl-device.yaml]

properties:
  reg:
    required: true
  clocks:
    required: true
  resets:
    required: true
  pinctrl-0:
    required: true
  pinctrl-names:
    required: true
  display-engine:
    type: phandle
    required: true
    description: Display engine supplying pixel data and panel timings
  enable-gpios:
    type: phandle-array
    required: true
    description: Panel enable signal, asserted after pixel output starts
  data-mapping:
    type: string
    required: true
    enum: [vesa-24, jeida-24, jeida-18]
    description: LVDS pixel data mapping
  link:
    type: int
    default: 0
    enum: [0]
    description: Physical LVDS link used for single-link output
```

## dts/bindings/display/artinchip,d13x-rgb.yaml
```yaml
# SPDX-FileCopyrightText: Copyright (c) 2026 UltraSemi Technology Development Co., Ltd.
# SPDX-License-Identifier: Apache-2.0

description: ArtInChip D13x RGB display output

compatible: "artinchip,d13x-rgb"

include: [base.yaml, pinctrl-device.yaml, reset-device.yaml]

properties:
  reg:
    required: true

  clocks:
    required: true

  artinchip,mode:
    type: int
    default: 0
    description: |
      RGB output mode. 0 selects PRGB, 1 selects SRGB, matching luban-lite
      PRGB/SRGB values.

  artinchip,format:
    type: int
    default: 0
    description: |
      RGB output format. For PRGB, 0 is 24-bit, 1 is 18-bit low-data,
      2 is 18-bit high-data, 3 is 16-bit low-data, and 4 is 16-bit high-data.
      For SRGB, 0 is 8-bit and 1 is 6-bit.

  artinchip,data-order:
    type: int
    default: 0x02100210
    description:
      RGB output data order register value. The default is luban-lite RGB.

  artinchip,clock-phase:
    type: int
    default: 0
    description:
      RGB pixel clock output phase. Values 0, 1, 2, and 3 select 0, 90,
      180, and 270 degrees respectively.

  artinchip,data-mirror:
    type: boolean
    description: Enable luban-lite RGB data mirror mode.

  artinchip,manual-start:
    type: boolean
    description:
      Register the RGB output device without enabling clocks or touching
      registers during boot. The hardware can be started through shell
      diagnostics.
```

## dts/bindings/display/artinchip,d21x-de.yaml
```yaml
# SPDX-FileCopyrightText: Copyright (c) 2026 UltraSemi
# SPDX-License-Identifier: Apache-2.0

description: ArtInChip D21x DE controller

compatible: "artinchip,d21x-de"

include: artinchip,d13x-de.yaml
```

## dts/bindings/display/artinchip,d21x-lvds.yaml
```yaml
# SPDX-FileCopyrightText: Copyright (c) 2026 UltraSemi
# SPDX-License-Identifier: Apache-2.0

description: ArtInChip D21x LVDS controller

compatible: "artinchip,d21x-lvds"

include:
  - name: artinchip,d13x-lvds.yaml
    property-blocklist: [link]

properties:
  link:
    type: int
    default: 0
    enum: [0, 1]
    description: Physical LVDS link used for single-link output
```

## dts/bindings/display/artinchip,pos-display-pipeline.yaml
```yaml
# SPDX-License-Identifier: Apache-2.0

description: ArtInChip POS MIPI-DSI display pipeline coordinator

compatible: "artinchip,pos-display-pipeline"

include: base.yaml

properties:
  dsi-host:
    type: phandle
    required: true
    description: ArtInChip MIPI DSI host controller

  panel:
    type: phandle
    required: true
    description: POS MIPI DSI panel device

  display-engine:
    type: phandle
    required: true
    description: ArtInChip display engine supplying pixels to the DSI host
```

## dts/bindings/display/artinchip,pos-panel.yaml
```yaml
# SPDX-FileCopyrightText: Copyright (c) 2026 UltraSemi Technology Development Co., Ltd.
# SPDX-License-Identifier: Apache-2.0

description: ArtInChip 720x1280 multi-vendor POS MIPI-DSI panel

compatible: "artinchip,pos-panel"

include: [mipi-dsi-device.yaml, display-controller.yaml]

properties:
  reset-gpios:
    type: phandle-array
    required: true

  bl-gpios:
    type: phandle-array
    required: true

  hfront-porch:
    type: int
    default: 80

  hback-porch:
    type: int
    default: 84

  hsync-len:
    type: int
    default: 23

  vfront-porch:
    type: int
    default: 19

  vback-porch:
    type: int
    default: 20

  vsync-len:
    type: int
    default: 4
```

## dts/bindings/display/fitipower,ek79007ad.yaml
```yaml
# SPDX-FileCopyrightText: Copyright (c) 2026 UltraSemi Technology Development Co., Ltd.
# SPDX-License-Identifier: Apache-2.0

description: Fitipower EK79007AD 1024x600 MIPI-DSI panel

compatible: "fitipower,ek79007ad"

include: [mipi-dsi-device.yaml, display-controller.yaml]

properties:
  reset-gpios:
    type: phandle-array
    description:
      Optional panel reset GPIO. The signal is treated as active low when
      GPIO_ACTIVE_LOW is present in the board devicetree.

  bl-gpios:
    type: phandle-array
    description: Optional active-high backlight enable GPIO.

  hfront-porch:
    type: int
    default: 160

  hback-porch:
    type: int
    default: 160

  hsync-len:
    type: int
    default: 20

  vfront-porch:
    type: int
    default: 12

  vback-porch:
    type: int
    default: 20

  vsync-len:
    type: int
    default: 2
```
