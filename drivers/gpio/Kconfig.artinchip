## drivers/gpio/Kconfig.artinchip
```kconfig
# SPDX-FileCopyrightText: Copyright (c) 2026 UltraSemi Technology Development Co., Ltd.
# SPDX-License-Identifier: Apache-2.0

config GPIO_ARTINCHIP
	bool "ArtInChip GPIO driver"
	default y
	depends on DT_HAS_ARTINCHIP_D13X_GPIO_ENABLED || DT_HAS_ARTINCHIP_D12P_GPIO_ENABLED
	help
	  Enable the GPIO driver for ArtInChip SoCs.
```

## drivers/hwinfo/Kconfig.artinchip
```kconfig
# SPDX-FileCopyrightText: Copyright (c) 2026 UltraSemi Technology Development Co., Ltd.
# SPDX-License-Identifier: Apache-2.0

config HWINFO_ARTINCHIP
	bool "ArtInChip hardware information"
	default y
	depends on SOC_SERIES_D13X || SOC_SERIES_D12P
	select HWINFO_HAS_DRIVER
	help
	  Enable reset-cause reporting from the ArtInChip WRI block, and (when
	  the SID/eFuse node is present) device-ID reporting from the chip
	  unique ID.
```

## drivers/i2c/Kconfig.artinchip
```kconfig
# SPDX-FileCopyrightText: Copyright (c) 2026 UltraSemi Technology Development Co., Ltd.
# SPDX-License-Identifier: Apache-2.0

config I2C_ARTINCHIP
	bool "ArtInChip I2C controller"
	default y
	depends on DT_HAS_ARTINCHIP_D13X_I2C_ENABLED
	select PINCTRL
	help
	  Enable the polling-mode controller driver for ArtInChip I2C.
```

## drivers/i2s/Kconfig.artinchip
```kconfig
# SPDX-FileCopyrightText: Copyright (c) 2026 UltraSemi Technology Development Co., Ltd.
# SPDX-License-Identifier: Apache-2.0

config I2S_ARTINCHIP
	bool "ArtInChip I2S controller"
	default y
	depends on DT_HAS_ARTINCHIP_D13X_I2S_ENABLED
	select RESET
	help
	  Enable the ArtInChip I2S controller. DMA-backed streaming is not
	  implemented yet; configuration and trigger operations are supported.
```

## drivers/input/Kconfig.rtp_artinchip
```kconfig
# SPDX-FileCopyrightText: Copyright (c) 2026 UltraSemi Technology Development Co., Ltd.
# SPDX-License-Identifier: Apache-2.0

config INPUT_ARTINCHIP_RTP
	bool "ArtInChip resistive touchscreen controller"
	default y
	depends on DT_HAS_ARTINCHIP_D13X_RTP_ENABLED
	depends on CLOCK_CONTROL && RESET
	select INPUT_TOUCH
	help
	  Enable the integrated resistive touchscreen controller on ArtInChip
	  ArtInChip SoCs.
```

## drivers/memc/Kconfig.artinchip
```kconfig
# SPDX-FileCopyrightText: Copyright (c) 2026 UltraSemi Technology Development Co., Ltd.
# SPDX-License-Identifier: Apache-2.0

config MEMC_ARTINCHIP_XSPI
	bool "ArtInChip XSPI memory controller"
	default y
	depends on DT_HAS_ARTINCHIP_D13X_XSPI_ENABLED
	depends on CLOCK_CONTROL
	depends on RESET
	help
	  Validate and preserve the XSPI PSRAM configuration inherited from
	  the ArtInChip pre-boot firmware.
```

## drivers/mipi_dsi/Kconfig.artinchip
```kconfig
# SPDX-FileCopyrightText: Copyright (c) 2026 UltraSemi Technology Development Co., Ltd.
# SPDX-License-Identifier: Apache-2.0

config MIPI_DSI_ARTINCHIP
	bool "ArtInChip MIPI DSI host driver"
	default y
	depends on DT_HAS_ARTINCHIP_D13X_MIPI_DSI_ENABLED
	depends on CLOCK_CONTROL
	depends on RESET
	select PINCTRL
	help
	  Enable the MIPI DSI host controller driver for ArtInChip SoCs.

config MIPI_DSI_ARTINCHIP_SHELL
	bool "ArtInChip MIPI DSI shell commands"
	depends on MIPI_DSI_ARTINCHIP
	depends on SHELL
	help
	  Enable diagnostic shell commands for the ArtInChip MIPI DSI host.

config MIPI_DSI_ARTINCHIP_AUTO_ENABLE_SEQUENCE
	bool "Allow deferred panel init without DSI shell"
	depends on MIPI_DSI_ARTINCHIP
	help
	  Satisfies CONFIG_EK79007AD_DEFER_PANEL_INIT when the application
	  (or a board-level pipeline) will run the DSI display enable
	  sequence outside of MIPI_DSI_ARTINCHIP_SHELL. Does not itself
	  register an automatic bring-up handler.
```

## drivers/misc/artinchip_adcim/Kconfig
```kconfig
# SPDX-FileCopyrightText: Copyright (c) 2026 UltraSemi Technology Development Co., Ltd.
# SPDX-License-Identifier: Apache-2.0

config ARTINCHIP_ADCIM
	bool "ArtInChip ADC interface manager"
	default y
	depends on DT_HAS_ARTINCHIP_D13X_ADCIM_ENABLED
	depends on CLOCK_CONTROL && RESET
	help
	  Enable the shared ADC calibration interface used by ArtInChip analog
	  peripherals.

config ARTINCHIP_ADCIM_INIT_PRIORITY
	int "ADC interface manager init priority"
	default 49
	depends on ARTINCHIP_ADCIM
	help
	  Initialize ADCIM before ADC consumers, whose default priority is 50.
```

## drivers/misc/artinchip_axicfg/Kconfig
```kconfig
# SPDX-FileCopyrightText: Copyright (c) 2026 UltraSemi Technology Development Co., Ltd.
# SPDX-License-Identifier: Apache-2.0
config ARTINCHIP_AXICFG
	bool "ArtInChip AXI bus configuration controller"
	default y
	depends on DT_HAS_ARTINCHIP_D13X_AXICFG_ENABLED
```

## drivers/misc/artinchip_ce/Kconfig
```kconfig
# SPDX-FileCopyrightText: Copyright (c) 2026 UltraSemi Technology Development Co., Ltd.
# SPDX-License-Identifier: Apache-2.0

config ARTINCHIP_CE
	bool "ArtInChip crypto engine controller"
	default y
	depends on DT_HAS_ARTINCHIP_D13X_CE_ENABLED
	depends on CLOCK_CONTROL && RESET
	help
	  Enable low-level control and status access for the ArtInChip crypto engine.
```

## drivers/misc/artinchip_cir/Kconfig
```kconfig
# SPDX-FileCopyrightText: Copyright (c) 2026 UltraSemi Technology Development Co., Ltd.
# SPDX-License-Identifier: Apache-2.0

config ARTINCHIP_CIR
	bool "ArtInChip consumer infrared controller"
	default y
	depends on DT_HAS_ARTINCHIP_D13X_CIR_ENABLED
	depends on CLOCK_CONTROL && RESET
	help
	  Enable raw infrared pulse frame reception on the ArtInChip CIR controller.
```

## drivers/misc/artinchip_ge/Kconfig
```kconfig
# SPDX-FileCopyrightText: Copyright (c) 2026 UltraSemi Technology Development Co., Ltd.
# SPDX-License-Identifier: Apache-2.0
config ARTINCHIP_GE
	bool "ArtInChip 2D graphics engine"
	default y
	depends on DT_HAS_ARTINCHIP_D13X_GE_ENABLED
	depends on CLOCK_CONTROL && RESET
```

## drivers/misc/artinchip_mtop/Kconfig
```kconfig
# SPDX-FileCopyrightText: Copyright (c) 2026 UltraSemi Technology Development Co., Ltd.
# SPDX-License-Identifier: Apache-2.0
config ARTINCHIP_MTOP
	bool "ArtInChip memory bandwidth monitor"
	default y
	depends on DT_HAS_ARTINCHIP_D13X_MTOP_ENABLED
	depends on CLOCK_CONTROL && RESET
```

## drivers/misc/artinchip_reboot/Kconfig
```kconfig
# SPDX-FileCopyrightText: Copyright (c) 2026 UltraSemi Technology Development Co., Ltd.
# SPDX-License-Identifier: Apache-2.0

config ARTINCHIP_REBOOT_SHELL
	bool "ArtInChip reboot shell commands"
	default y if SHELL
	depends on SHELL
	depends on SOC_FAMILY_ARTINCHIP
	depends on DT_HAS_ARTINCHIP_D13X_WRI_ENABLED || DT_HAS_ARTINCHIP_D21X_WRI_ENABLED
	select REBOOT
	help
	  Enable ArtInChip-specific reboot commands, including UART shell
	  helpers for entering BROM upgrade mode.
```

## drivers/misc/artinchip_spienc/Kconfig
```kconfig
# SPDX-FileCopyrightText: Copyright (c) 2026 UltraSemi Technology Development Co., Ltd.
# SPDX-License-Identifier: Apache-2.0

config ARTINCHIP_SPIENC
	bool "ArtInChip SPI inline encryption"
	default y
	depends on DT_HAS_ARTINCHIP_D13X_SPIENC_ENABLED
	depends on CLOCK_CONTROL && RESET
	help
	  Enable the ArtInChip inline SPI encryption path. Enabling this driver does
	  not attach or start encryption until requested by an application.
```

## drivers/misc/artinchip_usb/Kconfig
```kconfig
# SPDX-FileCopyrightText: Copyright (c) 2026 UltraSemi Technology Development Co., Ltd.
# SPDX-License-Identifier: Apache-2.0

config ARTINCHIP_USB
	bool "ArtInChip USB controller bring-up"
	default y
	depends on DT_HAS_ARTINCHIP_D13X_USB_ENABLED
	depends on CLOCK_CONTROL && RESET
	help
	  Enable low-level clock, reset, and diagnostic access for the ArtInChip
	  USB device/host/PHY block.

config ARTINCHIP_USB_SHELL
	bool "ArtInChip USB shell commands"
	depends on ARTINCHIP_USB
	depends on SHELL
	help
	  Enable diagnostic shell commands for the ArtInChip USB block.
```

## drivers/misc/artinchip_ve/Kconfig
```kconfig
# SPDX-FileCopyrightText: Copyright (c) 2026 UltraSemi Technology Development Co., Ltd.
# SPDX-License-Identifier: Apache-2.0
config ARTINCHIP_VE
	bool "ArtInChip video engine"
	default y
	depends on DT_HAS_ARTINCHIP_D13X_VE_ENABLED
	depends on CLOCK_CONTROL && RESET
```

## drivers/otp/Kconfig.artinchip
```kconfig
# SPDX-FileCopyrightText: Copyright (c) 2026 UltraSemi Technology Development Co., Ltd.
# SPDX-License-Identifier: Apache-2.0

config OTP_ARTINCHIP
	bool "ArtInChip eFuse"
	default y
	depends on DT_HAS_ARTINCHIP_D13X_EFUSE_ENABLED
	depends on CLOCK_CONTROL && RESET
	help
	  Enable read-only access to the ArtInChip eFuse/SID block.
```

## drivers/pinctrl/Kconfig.artinchip
```kconfig
# SPDX-FileCopyrightText: Copyright (c) 2026 UltraSemi Technology Development Co., Ltd.
# SPDX-License-Identifier: Apache-2.0

config PINCTRL_ARTINCHIP
	bool "ArtInChip pin controller"
	default y
	depends on DT_HAS_ARTINCHIP_PINCTRL_ENABLED
	help
	  Enable pin function, pull resistor, and drive strength configuration
	  for ArtInChip SoCs.
```

## drivers/pwm/Kconfig.artinchip
```kconfig
# SPDX-FileCopyrightText: Copyright (c) 2026 UltraSemi Technology Development Co., Ltd.
# SPDX-License-Identifier: Apache-2.0

config PWM_ARTINCHIP
	bool "ArtInChip PWM driver"
	default y
	depends on DT_HAS_ARTINCHIP_D13X_PWM_ENABLED
	select PINCTRL
	help
	  Enable the four-channel PWM controller on ArtInChip SoCs.

config PWM_ARTINCHIP_PWMCS
	bool "ArtInChip enhanced PWM controller"
	default y
	depends on DT_HAS_ARTINCHIP_D13X_PWMCS_ENABLED
	depends on CLOCK_CONTROL && RESET
	help
	  Enable the enhanced PWM channels in the ArtInChip PWM control subsystem.
```

## drivers/reset/Kconfig.artinchip
```kconfig
# SPDX-FileCopyrightText: Copyright (c) 2026 UltraSemi Technology Development Co., Ltd.
# SPDX-License-Identifier: Apache-2.0

config RESET_ARTINCHIP
	bool "ArtInChip reset controller"
	default y
	depends on DT_HAS_ARTINCHIP_D13X_RCTL_ENABLED
	help
	  Enable peripheral reset control support for ArtInChip SoCs.
```

## drivers/rtc/Kconfig.artinchip
```kconfig
# SPDX-FileCopyrightText: Copyright (c) 2026 UltraSemi Technology Development Co., Ltd.
# SPDX-License-Identifier: Apache-2.0

config RTC_ARTINCHIP
	bool "ArtInChip RTC driver"
	default y
	depends on DT_HAS_ARTINCHIP_D13X_RTC_ENABLED
	depends on CLOCK_CONTROL && RESET
	help
	  Enable the real-time clock driver for ArtInChip SoCs.
```

## drivers/sdhc/Kconfig.artinchip
```kconfig
# SPDX-FileCopyrightText: Copyright (c) 2026 UltraSemi Technology Development Co., Ltd.
# SPDX-License-Identifier: Apache-2.0

config SDHC_ARTINCHIP
	bool "ArtInChip SD/MMC controller"
	default y
	depends on DT_HAS_ARTINCHIP_D13X_SDMC_ENABLED
	depends on CLOCK_CONTROL && RESET
	select SDHC_SUPPORTS_NATIVE_MODE
	select PINCTRL
	help
	  Enable the ArtInChip SD/MMC host controller. The initial driver
	  uses polling PIO transfers.
```

## drivers/sensor/artinchip/Kconfig
```kconfig
# SPDX-FileCopyrightText: Copyright (c) 2026 UltraSemi Technology Development Co., Ltd.
# SPDX-License-Identifier: Apache-2.0

config ARTINCHIP_TSEN
	bool "ArtInChip temperature sensor"
	default y
	depends on DT_HAS_ARTINCHIP_D13X_TSEN_ENABLED
	depends on CLOCK_CONTROL && RESET
	help
	  Enable the on-chip temperature sensor controller on ArtInChip
	  SoCs. The initial driver exposes the CPU thermal sensor using one-shot
	  polling.
```

## drivers/serial/Kconfig.artinchip
```kconfig
# SPDX-FileCopyrightText: Copyright (c) 2026 UltraSemi Technology Development Co., Ltd.
# SPDX-License-Identifier: Apache-2.0

config UART_ARTINCHIP_V14
	bool "ArtInChip bootloader-configured UART driver"
	default y
	depends on (DT_HAS_ARTINCHIP_D12P_UART_ENABLED && !UART_ARTINCHIP_D12P_NATIVE) || DT_HAS_ARTINCHIP_BOOT_UART_ENABLED
	select SERIAL_HAS_DRIVER
	select SERIAL_SUPPORT_INTERRUPT
	help
	  Enable polling and interrupt-driven access to the common register subset
	  of ArtInChip UART v1.0, v1.1, and v1.4 that has already been
	  initialized by the pre-boot firmware. Native
	  CMU, reset, and pinctrl initialization is not yet performed.

config UART_ARTINCHIP_V11
	bool "ArtInChip UART v1.1/v1.4 driver"
	default y
	depends on DT_HAS_ARTINCHIP_D13X_UART_ENABLED || UART_ARTINCHIP_D12P_NATIVE
	depends on CLOCK_CONTROL
	depends on RESET
	select SERIAL_HAS_DRIVER
	select SERIAL_SUPPORT_INTERRUPT
	select SERIAL_SUPPORT_ASYNC
	help
	  Enable the ArtInChip UART v1.1/v1.4 driver. The hardware is 16550-derived
	  with ArtInChip-specific FIFO, status, RS485, and receiver control
	  registers. Enable CONFIG_UART_ASYNC_API and CONFIG_DMA_ARTINCHIP
	  to use DMA-backed async transfers on UART nodes with dmas properties.

config UART_ARTINCHIP_D12P_NATIVE
	bool "Initialize D12P UART using Zephyr device APIs"
	depends on DT_HAS_ARTINCHIP_D12P_UART_ENABLED
	depends on CLOCK_CONTROL && RESET && PINCTRL
	help
	  Configure the D12P UART using its devicetree clocks, resets and
	  pinctrl state instead of inheriting settings from boot firmware.
```
