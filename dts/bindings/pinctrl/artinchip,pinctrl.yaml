## dts/bindings/pinctrl/artinchip,pinctrl.yaml
```yaml
# SPDX-FileCopyrightText: Copyright (c) 2026 UltraSemi Technology Development Co., Ltd.
# SPDX-License-Identifier: Apache-2.0

title: ArtInChip Pin Controller

description: Controls ArtInChip pin functions, pull resistors, and drive strength

compatible: "artinchip,pinctrl"

include: [base.yaml, reset-device.yaml]

properties:
  reg:
    required: true

child-binding:
  child-binding:
    include:
      - name: pincfg-node.yaml
        property-allowlist:
          - bias-disable
          - bias-pull-down
          - bias-pull-up

    properties:
      pinmux:
        required: true
        type: array
        description: |
          Pin selections encoded with ARTINCHIP_PINMUX().

          The cell layout follows the ArtInChip luban-lite FDT pinmux
          convention:

            bits [31:24]: GPIO group index
            bits [23:16]: pin index within the group
            bits [15:8]: alternate function
            bits [7:4]: pull setting
            bits [3:0]: drive strength

          Zephyr pin configuration properties in this node, such as bias-* and
          artinchip,drive-strength, are used as the applied pull and drive
          settings.

      artinchip,drive-strength:
        type: int
        default: 3
        description: Hardware drive strength index from 0 through 7
```

## dts/bindings/pwm/artinchip,d13x-pwm.yaml
```yaml
# SPDX-FileCopyrightText: Copyright (c) 2026 UltraSemi Technology Development Co., Ltd.
# SPDX-License-Identifier: Apache-2.0

description: ArtInChip D13x PWM controller

compatible: "artinchip,d13x-pwm"

include: [pwm-controller.yaml, pinctrl-device.yaml, reset-device.yaml, base.yaml]

properties:
  reg:
    required: true

  clocks:
    required: true

  resets:
    required: true

  "#pwm-cells":
    const: 3

  channels:
    const: 4

pwm-cells:
  - channel
  - period
  - flags
```

## dts/bindings/pwm/artinchip,d13x-pwmcs.yaml
```yaml
# SPDX-FileCopyrightText: Copyright (c) 2026 UltraSemi Technology Development Co., Ltd.
# SPDX-License-Identifier: Apache-2.0
description: ArtInChip D13x enhanced PWM controller
compatible: "artinchip,d13x-pwmcs"
include: [pwm-controller.yaml, reset-device.yaml, base.yaml]
properties:
  reg:
    required: true
  clocks:
    required: true
  channels:
    const: 24
  "#pwm-cells":
    const: 3
pwm-cells:
  - channel
  - period
  - flags
```

## dts/bindings/reset/artinchip,d12p-rctl.yaml
```yaml
# SPDX-FileCopyrightText: Copyright (c) 2026 UltraSemi Technology Development Co., Ltd.
# SPDX-License-Identifier: Apache-2.0

title: ArtInChip D12P Reset Controller

description: Controls the active-low reset lines for D12P peripherals

compatible: "artinchip,d12p-rctl"

include: artinchip,d13x-rctl.yaml
```

## dts/bindings/reset/artinchip,d13x-rctl.yaml
```yaml
# SPDX-FileCopyrightText: Copyright (c) 2026 UltraSemi Technology Development Co., Ltd.
# SPDX-License-Identifier: Apache-2.0

title: ArtInChip D13x Reset Controller

description: Controls the active-low reset lines for D13x peripherals

compatible: "artinchip,d13x-rctl"

include: [reset-controller.yaml, base.yaml]

properties:
  "#reset-cells":
    const: 1

reset-cells:
  - id
```

## dts/bindings/reset/artinchip,d21x-rctl.yaml
```yaml
# SPDX-FileCopyrightText: Copyright (c) 2026 UltraSemi
# SPDX-License-Identifier: Apache-2.0

description: ArtInChip D21x reset controller (UART, GPIO and QSPI bring-up)
compatible: "artinchip,d21x-rctl"
include: artinchip,d13x-rctl.yaml
```

## dts/bindings/rtc/artinchip,d13x-rtc.yaml
```yaml
# SPDX-FileCopyrightText: Copyright (c) 2026 UltraSemi Technology Development Co., Ltd.
# SPDX-License-Identifier: Apache-2.0

description: ArtInChip D13x real-time clock

compatible: "artinchip,d13x-rtc"

include:
  - rtc-device.yaml
  - reset-device.yaml

properties:
  reg:
    required: true

  clocks:
    required: true

  interrupts:
    required: true
```

## dts/bindings/rtc/artinchip,d21x-rtc.yaml
```yaml
# SPDX-FileCopyrightText: Copyright (c) 2026 UltraSemi Technology Development Co., Ltd.
# SPDX-License-Identifier: Apache-2.0

description: ArtInChip D21x real-time clock

compatible: "artinchip,d21x-rtc"

include:
  - rtc-device.yaml
  - reset-device.yaml

properties:
  reg:
    required: true

  clocks:
    required: true

  interrupts:
    required: true
```

## dts/bindings/sdhc/artinchip,d13x-sdmc.yaml
```yaml
# SPDX-FileCopyrightText: Copyright (c) 2026 UltraSemi Technology Development Co., Ltd.
# SPDX-License-Identifier: Apache-2.0

description: ArtInChip D13x SD/MMC host controller

compatible: "artinchip,d13x-sdmc"

include:
  - sdhc.yaml
  - reset-device.yaml
  - pinctrl-device.yaml

properties:
  reg:
    required: true

  clocks:
    required: true

  interrupts:
    required: true

  bus-width:
    type: int
    default: 4
    enum: [1, 4, 8]

  artinchip,drive-phase:
    type: int
    default: 3
    enum: [0, 1, 2, 3]

  artinchip,sample-phase:
    type: int
    default: 0
    enum: [0, 1, 2, 3]
```

## dts/bindings/sensor/artinchip,d13x-tsen.yaml
```yaml
# SPDX-FileCopyrightText: Copyright (c) 2026 UltraSemi Technology Development Co., Ltd.
# SPDX-License-Identifier: Apache-2.0

description: ArtInChip D13x on-chip temperature sensor

compatible: "artinchip,d13x-tsen"

include:
  - sensor-device.yaml
  - reset-device.yaml

properties:
  reg:
    required: true

  clocks:
    required: true

  artinchip,channel:
    type: int
    required: true
    description: Hardware temperature sensor channel

  artinchip,slope:
    type: int
    required: true
    description: Calibration slope scaled by 10000

  artinchip,offset:
    type: int
    required: true
    description: Calibration offset scaled by 10000
```

## dts/bindings/serial/artinchip,boot-uart.yaml
```yaml
# SPDX-FileCopyrightText: Copyright (c) 2026 UltraSemi Technology Development Co., Ltd.
# SPDX-License-Identifier: Apache-2.0

description: ArtInChip bootloader-configured UART v1.0/v1.1/v1.4 register subset

compatible: "artinchip,boot-uart"

include: uart-controller.yaml

properties:
  reg:
    required: true

  interrupts:
    required: true

  current-speed:
    required: true

  artinchip,bootloader-configured:
    type: boolean
    required: true
    description: |
      The pre-boot firmware configured the UART clock, reset, pin multiplexing,
      baud rate, framing, and FIFO before starting Zephyr.
```

## dts/bindings/serial/artinchip,d12p-uart.yaml
```yaml
# SPDX-FileCopyrightText: Copyright (c) 2026 UltraSemi Technology Development Co., Ltd.
# SPDX-License-Identifier: Apache-2.0

description: ArtInChip D12P UART controller

compatible: "artinchip,d12p-uart"

include: [uart-controller.yaml, reset-device.yaml, pinctrl-device.yaml]

properties:
  reg:
    required: true

  interrupts:
    required: true

  current-speed:
    required: true

  artinchip,bootloader-configured:
    type: boolean
    description: |
      The pre-boot firmware configured the UART clock, reset, pin multiplexing,
      baud rate, framing, and FIFO before starting Zephyr.
```

## dts/bindings/serial/artinchip,d13x-uart.yaml
```yaml
# SPDX-FileCopyrightText: Copyright (c) 2026 UltraSemi Technology Development Co., Ltd.
# SPDX-License-Identifier: Apache-2.0

description: ArtInChip D13x UART controller

compatible: "artinchip,d13x-uart"

include: [uart-controller.yaml, reset-device.yaml, pinctrl-device.yaml]

properties:
  reg:
    required: true

  clocks:
    required: true

  resets:
    required: true

  interrupts:
    required: true

  current-speed:
    required: true

  dmas:
    description: Optional DMA channels for async TX and RX

  dma-names:
    description: Must be "tx" and "rx" when DMA is used

  artinchip,rs485-mode:
    type: string
    default: "rs232"
    description: UART operating mode
    enum:
      - "rs232"
      - "rs485"
      - "rs485-compact-io"
      - "rs485-simulation"
```

## dts/bindings/serial/artinchip,d21x-uart.yaml
```yaml
# SPDX-FileCopyrightText: Copyright (c) 2026 UltraSemi
# SPDX-License-Identifier: Apache-2.0

description: ArtInChip D21x UART controller

compatible: "artinchip,d21x-uart"

include: artinchip,d13x-uart.yaml
```

## dts/bindings/spi/artinchip,boot-spi.yaml
```yaml
# SPDX-FileCopyrightText: Copyright (c) 2026 UltraSemi Technology Development Co., Ltd.
# SPDX-License-Identifier: Apache-2.0

description: |
  ArtInChip QSPI storage metadata owned by pre-boot firmware. This binding
  describes the bus for partition discovery; no runtime driver is provided.
  The controller must remain disabled until a native driver is supplied.
compatible: "artinchip,boot-spi"
include: spi-controller.yaml
properties:
  reg:
    required: true
```

## dts/bindings/spi/artinchip,d12p-qspi.yaml
```yaml
# SPDX-License-Identifier: Apache-2.0
title: ArtInChip D12P QSPI v3.4 controller
description: |
  Uses the standard ArtInChip FIFO register interface with a fixed divide-by-two
  stage before the programmable clock dividers. Bootloader-configured operation
  preserves the PBP/tinySPL clock and pin routing, including SiP flash routing.
compatible: "artinchip,d12p-qspi"
include: artinchip,d13x-qspi.yaml
```

## dts/bindings/spi/artinchip,d13x-qspi.yaml
```yaml
# SPDX-FileCopyrightText: Copyright (c) 2026 UltraSemi Technology Development Co., Ltd.
# SPDX-License-Identifier: Apache-2.0

title: ArtInChip D13x QSPI controller

description: |
  ArtInChip D13x QSPI controller used in standard single-line SPI mode.
  The controller also supports flash-oriented dual and quad transfers,
  which are not yet exposed by the Zephyr driver.

compatible: "artinchip,d13x-qspi"

include: [spi-controller.yaml, pinctrl-device.yaml, reset-device.yaml]

properties:
  reg:
    required: true

  clocks:
    required: true

  clock-frequency:
    required: true
    description: QSPI controller input clock frequency in Hz

  interrupts:
    required: true

  pinctrl-0:
    required: true

  pinctrl-names:
    required: true

  artinchip,bootloader-configured:
    type: boolean
    description: |
      Bootloader already initialized the controller. D13x skips controller reset.
      D12P preserves the clock, pins and SoC reset line, but reinitializes the
      controller FIFO for polling SPI.
```

## dts/bindings/spi/artinchip,d21x-qspi.yaml
```yaml
# SPDX-FileCopyrightText: Copyright (c) 2026 UltraSemi
# SPDX-License-Identifier: Apache-2.0

description: ArtInChip D21x spi controller (UART, GPIO and QSPI bring-up)
compatible: "artinchip,d21x-qspi"
include: artinchip,d13x-qspi.yaml
```

## dts/bindings/syscon/artinchip,d13x-syscfg.yaml
```yaml
# SPDX-FileCopyrightText: Copyright (c) 2026 UltraSemi Technology Development Co., Ltd.
# SPDX-License-Identifier: Apache-2.0

title: ArtInChip D13x system configuration registers

description: |
  Miscellaneous chip-level configuration registers for resources such as
  SRAM, USB, GMAC, debug routing, and internal voltage controls.

compatible: "artinchip,d13x-syscfg"

include: [base.yaml, reset-device.yaml]

properties:
  reg:
    required: true

  clocks:
    required: true

  resets:
    required: true
```

## dts/bindings/timer/riscv,machine-timer.yaml
```yaml
# Copyright (c) 2025 MASSDRIVER EI (massdriver.space)
# SPDX-License-Identifier: Apache-2.0

description: RISC-V Machine Timer.

compatible: "riscv,machine-timer"

include: base.yaml

properties:
  reg:
    required: true
  reg-names:
    required: true
  interrupts-extended:
    required: true
  clock-frequency:
    type: int
    description: Clock frequency in Hz
  reg-io-width:
    type: int
    enum: [4, 8]
    description: |
      Maximum supported MMIO access width in bytes. Set to 4 when the timer
      requires 32-bit accesses even on RV64. If omitted, the driver uses
      the native CPU word width. RV32 always uses 32-bit accesses.
```

## dts/bindings/usb/artinchip,d12p-usbd.yaml
```yaml
# SPDX-FileCopyrightText: Copyright (c) 2026 UltraSemi Technology Development Co., Ltd.
# SPDX-License-Identifier: Apache-2.0

description: ArtInChip D12P USB 2.0 device controller

compatible: "artinchip,d12p-usbd"

include: usb-controller.yaml

properties:
  reg:
    required: true

  interrupts:
    required: true

  num-in-eps:
    type: int
    required: true
    description: Number of IN endpoints, including control endpoint zero.

  num-out-eps:
    type: int
    required: true
    description: Number of OUT endpoints, including control endpoint zero.

  clocks:
    required: true

  clock-names:
    type: string-array
    required: true

  resets:
    type: phandle-array
    required: true

  reset-names:
    type: string-array
    required: true

  artinchip,syscfg:
    type: phandle
    required: true
    description: System configuration block containing USB0_CFG DRD mode bit.
```

## dts/bindings/video/artinchip,d12p-dvp.yaml
```yaml
# SPDX-FileCopyrightText: Copyright (c) 2026 UltraSemi Technology Development Co., Ltd.
# SPDX-License-Identifier: Apache-2.0

description: ArtInChip D12P digital video port receiver

compatible: "artinchip,d12p-dvp"

include: [base.yaml, reset-device.yaml, pinctrl-device.yaml]

properties:
  reg:
    required: true

  clocks:
    required: true

  interrupts:
    required: true

  data-width:
    type: int
    default: 8
    enum:
      - 8
      - 16
    description: Parallel sensor data bus width in bits.

  hsync-active:
    type: string
    default: "high"
    enum:
      - "low"
      - "high"
    description: Active level of the horizontal reference signal.

  vsync-active:
    type: string
    default: "high"
    enum:
      - "low"
      - "high"
    description: Active level of the vertical sync signal.

  pclk-sample:
    type: string
    default: "rising"
    enum:
      - "rising"
      - "falling"
    description: Pixel clock edge used to sample input data.
```

## dts/bindings/watchdog/artinchip,d13x-wdt.yaml
```yaml
# SPDX-FileCopyrightText: Copyright (c) 2026 UltraSemi Technology Development Co., Ltd.
# SPDX-License-Identifier: Apache-2.0

description: ArtInChip D13x watchdog

compatible: "artinchip,d13x-wdt"

include:
  - base.yaml
  - reset-device.yaml

properties:
  reg:
    required: true

  clocks:
    required: true

  interrupts:
    required: true
```

## dts/bindings/watchdog/artinchip,d21x-wdt.yaml
```yaml
# SPDX-FileCopyrightText: Copyright (c) 2026 UltraSemi Technology Development Co., Ltd.
# SPDX-License-Identifier: Apache-2.0

description: ArtInChip D21x watchdog v1.0

compatible: "artinchip,d21x-wdt"

include:
  - base.yaml
  - reset-device.yaml

properties:
  reg:
    required: true

  clocks:
    required: true

  interrupts:
    required: true
```

## samples/subsys/display/lvgl/boards/ultrasemi_d12p_usbdisp_demo88_nor_5_5.conf
```kconfig
# SPDX-FileCopyrightText: Copyright (c) 2026 UltraSemi
# SPDX-License-Identifier: Apache-2.0

CONFIG_GPIO=y
CONFIG_PINCTRL=y
CONFIG_MIPI_DSI=y
CONFIG_DISPLAY=y
CONFIG_DISPLAY_ARTINCHIP_POS_PIPELINE=y
CONFIG_DISPLAY_ARTINCHIP_POS_PANEL=y
CONFIG_ARTINCHIP_POS_PANEL_DEFER_PANEL_INIT=y
CONFIG_INPUT=n
CONFIG_INPUT_GT911=n
CONFIG_LV_Z_POINTER_INPUT=n
CONFIG_LV_Z_ENCODER_INPUT=n
CONFIG_LV_Z_KEYPAD_INPUT=n
CONFIG_LV_Z_AUTO_INIT=y
CONFIG_LV_Z_INIT_PRIORITY=95
CONFIG_LV_Z_RUN_LVGL_ON_WORKQUEUE=n
CONFIG_MAIN_THREAD_PRIORITY=5
CONFIG_SHELL_THREAD_PRIORITY_OVERRIDE=y
CONFIG_SHELL_THREAD_PRIORITY=2
CONFIG_LV_COLOR_DEPTH_16=y
CONFIG_LV_Z_VDB_SIZE=15
CONFIG_LV_Z_MEM_POOL_SIZE=1048576
CONFIG_MAIN_STACK_SIZE=12288
CONFIG_SYSTEM_WORKQUEUE_STACK_SIZE=4096
CONFIG_LV_Z_SHELL=n
CONFIG_SHELL=y
CONFIG_SHELL_BACKEND_SERIAL=y
CONFIG_LOG=y
CONFIG_LOG_MODE_DEFERRED=y
CONFIG_LOG_DEFAULT_LEVEL=3
```
