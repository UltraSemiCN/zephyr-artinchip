## dts/bindings/ethernet/mdio/artinchip,d13x-mdio.yaml
```yaml
# SPDX-FileCopyrightText: Copyright (c) 2026 UltraSemi Technology Development Co., Ltd.
# SPDX-License-Identifier: Apache-2.0

description: ArtInChip D13x GMAC MDIO controller

compatible: "artinchip,d13x-mdio"

include: mdio-controller.yaml
```

## dts/bindings/gpio/artinchip,d12p-gpio.yaml
```yaml
# SPDX-FileCopyrightText: Copyright (c) 2026 UltraSemi Technology Development Co., Ltd.
# SPDX-License-Identifier: Apache-2.0

description: ArtInChip D12P GPIO port

compatible: "artinchip,d12p-gpio"

include: artinchip,d13x-gpio.yaml
```

## dts/bindings/gpio/artinchip,d13x-gpio.yaml
```yaml
# SPDX-FileCopyrightText: Copyright (c) 2026 UltraSemi Technology Development Co., Ltd.
# SPDX-License-Identifier: Apache-2.0

description: ArtInChip D13x GPIO port

compatible: "artinchip,d13x-gpio"

include: [gpio-controller.yaml, base.yaml]

properties:
  reg:
    required: true

  clocks:
    required: true

  interrupts:
    required: true

  "#gpio-cells":
    const: 2

gpio-cells:
  - pin
  - flags
```

## dts/bindings/gpio/artinchip,d21x-gpio.yaml
```yaml
# SPDX-FileCopyrightText: Copyright (c) 2026 UltraSemi
# SPDX-License-Identifier: Apache-2.0

description: ArtInChip D21x GPIO controller

compatible: "artinchip,d21x-gpio"

include: artinchip,d13x-gpio.yaml
```

## dts/bindings/i2c/artinchip,d13x-i2c.yaml
```yaml
# SPDX-FileCopyrightText: Copyright (c) 2026 UltraSemi Technology Development Co., Ltd.
# SPDX-License-Identifier: Apache-2.0

description: ArtInChip D13x I2C controller

compatible: "artinchip,d13x-i2c"

include: [i2c-controller.yaml, pinctrl-device.yaml, reset-device.yaml]

properties:
  reg:
    required: true

  clocks:
    required: true

  resets:
    required: true

  interrupts:
    required: true

  artinchip,stuck-time-cycles:
    type: int
    default: 400
    description: SCL and SDA stuck detection time, in configured bus clock cycles
```

## dts/bindings/i2s/artinchip,d13x-i2s.yaml
```yaml
# SPDX-FileCopyrightText: Copyright (c) 2026 UltraSemi Technology Development Co., Ltd.
# SPDX-License-Identifier: Apache-2.0

description: ArtInChip D13x I2S controller

compatible: "artinchip,d13x-i2s"

include: [i2s-controller.yaml, reset-device.yaml]

properties:
  reg:
    required: true

  clocks:
    required: true

  interrupts:
    required: true
```

## dts/bindings/input/artinchip,d13x-rtp.yaml
```yaml
# SPDX-FileCopyrightText: Copyright (c) 2026 UltraSemi Technology Development Co., Ltd.
# SPDX-License-Identifier: Apache-2.0

description: ArtInChip D13x resistive touchscreen controller

compatible: "artinchip,d13x-rtp"

include:
  - touchscreen-common.yaml
  - reset-device.yaml

properties:
  reg:
    required: true

  clocks:
    required: true

  interrupts:
    required: true

  sample-period-ms:
    type: int
    default: 10
    description: Period between touch samples

  artinchip,delay:
    type: int
    default: 0
    description: Hardware delay register value
```

## dts/bindings/memory-controllers/artinchip,d13x-xspi.yaml
```yaml
# SPDX-FileCopyrightText: Copyright (c) 2026 UltraSemi Technology Development Co., Ltd.
# SPDX-License-Identifier: Apache-2.0

title: ArtInChip D13x XSPI memory controller

description: |
  ArtInChip D13x expanded serial peripheral interface used for memory-mapped
  PSRAM. The initial Zephyr driver validates and preserves configuration
  inherited from the pre-boot firmware.

compatible: "artinchip,d13x-xspi"

include: [base.yaml, reset-device.yaml]

properties:
  reg:
    required: true

  clocks:
    required: true

  resets:
    required: true

  interrupts:
    required: true

  memory-region:
    type: phandle
    required: true
    description: Memory-mapped PSRAM region configured by the bootloader

  artinchip,bootloader-configured:
    type: boolean
    required: true
    description: Preserve XSPI protocol, DLL training, and XIP configuration
```

## dts/bindings/mfd/artinchip,d13x-cmu.yaml
```yaml
# SPDX-FileCopyrightText: Copyright (c) 2026 UltraSemi Technology Development Co., Ltd.
# SPDX-License-Identifier: Apache-2.0

title: ArtInChip D13x Clock Management Unit

description: |
  The D13x Clock Management Unit contains peripheral clock gates, dividers,
  and reset controls. Child nodes represent the clock and reset controllers.

compatible: "artinchip,d13x-cmu"

include: base.yaml

properties:
  reg:
    required: true
```

## dts/bindings/mipi-dsi/artinchip,d12p-mipi-dsi.yaml
```yaml
description: ArtInChip D12P MIPI DSI host controller

compatible: "artinchip,d12p-mipi-dsi"

include: artinchip,d13x-mipi-dsi.yaml
```

## dts/bindings/mipi-dsi/artinchip,d13x-mipi-dsi.yaml
```yaml
# SPDX-FileCopyrightText: Copyright (c) 2026 UltraSemi Technology Development Co., Ltd.
# SPDX-License-Identifier: Apache-2.0

description: ArtInChip D13x MIPI DSI host controller

compatible: "artinchip,d13x-mipi-dsi"

include: [mipi-dsi-host.yaml, pinctrl-device.yaml, reset-device.yaml]

properties:
  reg:
    required: true

  clocks:
    required: true

  interrupts:
    required: true

  phy-clock:
    required: true

  artinchip,manual-phy-start:
    type: boolean
    description:
      Defer DSI PHY initialization from mipi_dsi_attach() to the ArtInChip DSI
      shell diagnostics. This is useful while validating boards where analog
      PHY registers may not be safe to touch during panel initialization.
```

## dts/bindings/misc/artinchip,d12p-sid.yaml
```yaml
# SPDX-FileCopyrightText: Copyright (c) 2026 UltraSemi Technology Development Co., Ltd.
# SPDX-License-Identifier: Apache-2.0

description: |
  ArtInChip D12p Secure ID (SID) / eFuse controller. Holds the factory
  programmed chip unique ID, used by the hwinfo driver as the device ID.

compatible: "artinchip,d12p-sid"

include: [base.yaml, reset-device.yaml]

properties:
  reg:
    required: true

  clocks:
    required: true

  resets:
    required: true
```

## dts/bindings/misc/artinchip,d13x-adcim.yaml
```yaml
# SPDX-FileCopyrightText: Copyright (c) 2026 UltraSemi Technology Development Co., Ltd.
# SPDX-License-Identifier: Apache-2.0

description: ArtInChip D13x ADC interface manager

compatible: "artinchip,d13x-adcim"

include:
  - base.yaml
  - reset-device.yaml

properties:
  reg:
    required: true

  clocks:
    required: true
```

## dts/bindings/misc/artinchip,d13x-axicfg.yaml
```yaml
# SPDX-FileCopyrightText: Copyright (c) 2026 UltraSemi Technology Development Co., Ltd.
# SPDX-License-Identifier: Apache-2.0

description: ArtInChip D13x AXI bus QoS and bandwidth controller

compatible: "artinchip,d13x-axicfg"

include: base.yaml

properties:
  reg:
    required: true
```

## dts/bindings/misc/artinchip,d13x-cir.yaml
```yaml
# SPDX-FileCopyrightText: Copyright (c) 2026 UltraSemi Technology Development Co., Ltd.
# SPDX-License-Identifier: Apache-2.0

description: ArtInChip D13x consumer infrared controller
compatible: "artinchip,d13x-cir"

include: [base.yaml, reset-device.yaml]

properties:
  reg:
    required: true
  clocks:
    required: true
  interrupts:
    required: true
```

## dts/bindings/misc/artinchip,d13x-ge.yaml
```yaml
# SPDX-FileCopyrightText: Copyright (c) 2026 UltraSemi Technology Development Co., Ltd.
# SPDX-License-Identifier: Apache-2.0
description: ArtInChip D13x 2D graphics engine
compatible: "artinchip,d13x-ge"
include: [base.yaml, reset-device.yaml]
properties:
  reg:
    required: true
  clocks:
    required: true
  interrupts:
    required: true
```

## dts/bindings/misc/artinchip,d13x-mtop.yaml
```yaml
# SPDX-FileCopyrightText: Copyright (c) 2026 UltraSemi Technology Development Co., Ltd.
# SPDX-License-Identifier: Apache-2.0
description: ArtInChip D13x memory bandwidth monitor
compatible: "artinchip,d13x-mtop"
include: [base.yaml, reset-device.yaml]
properties:
  reg:
    required: true
  clocks:
    required: true
  interrupts:
    required: true
```

## dts/bindings/misc/artinchip,d13x-pbus.yaml
```yaml
# SPDX-FileCopyrightText: Copyright (c) 2026 UltraSemi Technology Development Co., Ltd.
# SPDX-License-Identifier: Apache-2.0
description: ArtInChip D13x parallel bus controller and data window
compatible: "artinchip,d13x-pbus"
include: [base.yaml, reset-device.yaml]
properties:
  reg:
    required: true
  clocks:
    required: true
```

## dts/bindings/misc/artinchip,d13x-spienc.yaml
```yaml
# SPDX-FileCopyrightText: Copyright (c) 2026 UltraSemi Technology Development Co., Ltd.
# SPDX-License-Identifier: Apache-2.0

description: ArtInChip D13x inline SPI encryption controller

compatible: "artinchip,d13x-spienc"

include:
  - base.yaml
  - reset-device.yaml

properties:
  reg:
    required: true

  clocks:
    required: true
```

## dts/bindings/misc/artinchip,d13x-usb.yaml
```yaml
# SPDX-FileCopyrightText: Copyright (c) 2026 UltraSemi Technology Development Co., Ltd.
# SPDX-License-Identifier: Apache-2.0

description: ArtInChip D13x USB controller block

compatible: "artinchip,d13x-usb"

include: base.yaml

properties:
  reg:
    required: true

  reg-names:
    type: string-array
    required: true

  clocks:
    type: phandle-array
    required: true

  clock-names:
    type: string-array
    required: true

  resets:
    type: phandle-array
    required: true

  reset-names:
    type: string-array
    required: true

  interrupts:
    required: true

  interrupt-names:
    type: string-array
    required: true

  artinchip,syscfg:
    type: phandle
    required: true
    description: System configuration block containing the USB0 DRD mode bit.

  dr-mode:
    type: string
    default: "otg"
    enum:
      - "host"
      - "peripheral"
      - "otg"
    description:
      USB0 default role. D13x exposes separate USBD and USBH0 register
      windows sharing PHY0; the PHY role is selected through SYSCFG USB0_CFG.
```

## dts/bindings/misc/artinchip,d13x-ve.yaml
```yaml
# SPDX-FileCopyrightText: Copyright (c) 2026 UltraSemi Technology Development Co., Ltd.
# SPDX-License-Identifier: Apache-2.0

description: ArtInChip D13x video engine

compatible: "artinchip,d13x-ve"

include: [base.yaml, reset-device.yaml]

properties:
  reg:
    required: true
  clocks:
    required: true
  interrupts:
    required: true
```

## dts/bindings/misc/artinchip,d13x-wri.yaml
```yaml
# SPDX-FileCopyrightText: Copyright (c) 2026 UltraSemi Technology Development Co., Ltd.
# SPDX-License-Identifier: Apache-2.0

description: ArtInChip D13x warm reset information registers

compatible: "artinchip,d13x-wri"

include: base.yaml

properties:
  reg:
    required: true
```

## dts/bindings/misc/artinchip,d21x-wri.yaml
```yaml
# SPDX-FileCopyrightText: Copyright (c) 2026 UltraSemi Technology Development Co., Ltd.
# SPDX-License-Identifier: Apache-2.0

description: ArtInChip D21x warm reset information registers

compatible: "artinchip,d21x-wri"

include: base.yaml

properties:
  reg:
    required: true
```

## dts/bindings/mtd/artinchip,airburn-nand-map.yaml
```yaml
# SPDX-FileCopyrightText: Copyright (c) 2026 UltraSemi
# SPDX-License-Identifier: Apache-2.0

description: |
  Read-only view of AirBurn MTD images. Bad erase blocks are skipped separately
  within each fixed partition, matching the vendor USB updater. Reads never
  cross a physical partition boundary. This is not an NFTL device.
compatible: "artinchip,airburn-nand-map"
include: base.yaml
properties:
  flash:
    type: phandle
    required: true
  size-bytes:
    type: int
    required: true
  erase-block-size:
    type: int
    required: true
  write-block-size:
    type: int
    required: true
```

## dts/bindings/mtd/xtx,xt26g01c.yaml
```yaml
# SPDX-FileCopyrightText: Copyright (c) 2026 UltraSemi
# SPDX-License-Identifier: Apache-2.0

description: XTX XT26G01C SPI NAND with on-die ECC
compatible: "xtx,xt26g01c"
include: jedec,spi-nand.yaml
properties:
  size-bytes:
    const: 134217728
  plane-bytes:
    const: 134217728
  write-block-size:
    const: 2048
  erase-block-size:
    const: 131072
```
