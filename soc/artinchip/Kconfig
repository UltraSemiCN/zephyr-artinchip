## soc/artinchip/Kconfig
```kconfig
# SPDX-FileCopyrightText: Copyright (c) 2026 UltraSemi Technology Development Co., Ltd.
# SPDX-License-Identifier: Apache-2.0

if SOC_FAMILY_ARTINCHIP

rsource "*/Kconfig"

endif # SOC_FAMILY_ARTINCHIP
```

## soc/artinchip/Kconfig.defconfig
```kconfig
# SPDX-FileCopyrightText: Copyright (c) 2026 UltraSemi Technology Development Co., Ltd.
# SPDX-License-Identifier: Apache-2.0

if SOC_FAMILY_ARTINCHIP

DT_MTIMER_PATH := $(dt_nodelabel_path,mtimer)

config SYS_CLOCK_HW_CYCLES_PER_SEC
	default $(dt_node_int_prop_int,$(DT_MTIMER_PATH),clock-frequency)

rsource "*/Kconfig.defconfig"

endif # SOC_FAMILY_ARTINCHIP
```

## soc/artinchip/Kconfig.soc
```kconfig
# SPDX-FileCopyrightText: Copyright (c) 2026 UltraSemi Technology Development Co., Ltd.
# SPDX-License-Identifier: Apache-2.0

config SOC_FAMILY_ARTINCHIP
	bool

config SOC_FAMILY
	default "artinchip" if SOC_FAMILY_ARTINCHIP

rsource "*/Kconfig.soc"
```

## soc/artinchip/d11x/Kconfig
```kconfig
# SPDX-FileCopyrightText: Copyright (c) 2026 UltraSemi Technology Development Co., Ltd.
# SPDX-License-Identifier: Apache-2.0

config SOC_SERIES_D11X
	select RISCV
	select FPU
	select CPU_XUANTIE_E907
	select CACHE_MANAGEMENT
```

## soc/artinchip/d11x/Kconfig.soc
```kconfig
# SPDX-FileCopyrightText: Copyright (c) 2026 UltraSemi Technology Development Co., Ltd.
# SPDX-License-Identifier: Apache-2.0

config SOC_SERIES_D11X
	bool
	select SOC_FAMILY_ARTINCHIP

config SOC_SERIES
	default "d11x" if SOC_SERIES_D11X

config SOC_D11X
	bool
	select SOC_SERIES_D11X

config SOC
	default "d11x" if SOC_D11X
```

## soc/artinchip/d12p/Kconfig
```kconfig
# SPDX-FileCopyrightText: Copyright (c) 2026 UltraSemi Technology Development Co., Ltd.
# SPDX-License-Identifier: Apache-2.0

config SOC_SERIES_D12P
	select CACHE_MANAGEMENT
	select CPU_XUANTIE_E907
	select FPU
	select RISCV
```

## soc/artinchip/d12p/Kconfig.soc
```kconfig
# SPDX-FileCopyrightText: Copyright (c) 2026 UltraSemi Technology Development Co., Ltd.
# SPDX-License-Identifier: Apache-2.0

config SOC_SERIES_D12P
	bool
	select SOC_FAMILY_ARTINCHIP
	help
	  Enable support for the ArtInChip D12p SoC series.

config SOC_SERIES
	default "d12p" if SOC_SERIES_D12P

config SOC_D121BAV
	bool
	select SOC_SERIES_D12P

config SOC_D121BBV
	bool
	select SOC_SERIES_D12P

config SOC_D121BCV
	bool
	select SOC_SERIES_D12P

config SOC_D122BAV
	bool
	select SOC_SERIES_D12P

config SOC_D122BBV
	bool
	select SOC_SERIES_D12P

config SOC_D122BCV
	bool
	select SOC_SERIES_D12P

config SOC_D123BAV
	bool
	select SOC_SERIES_D12P

config SOC_D123BBV
	bool
	select SOC_SERIES_D12P

config SOC_D123BCV
	bool
	select SOC_SERIES_D12P

config SOC_D125CBR
	bool
	select SOC_SERIES_D12P

config SOC_D125CCV
	bool
	select SOC_SERIES_D12P

config SOC_D125CCR
	bool
	select SOC_SERIES_D12P

config SOC_D125DDR
	bool
	select SOC_SERIES_D12P

config SOC_D125EDR
	bool
	select SOC_SERIES_D12P

config SOC_D126FBV
	bool
	select SOC_SERIES_D12P

config SOC_D126FCV
	bool
	select SOC_SERIES_D12P

config SOC
	default "d121bav" if SOC_D121BAV
	default "d121bbv" if SOC_D121BBV
	default "d121bcv" if SOC_D121BCV
	default "d122bav" if SOC_D122BAV
	default "d122bbv" if SOC_D122BBV
	default "d122bcv" if SOC_D122BCV
	default "d123bav" if SOC_D123BAV
	default "d123bbv" if SOC_D123BBV
	default "d123bcv" if SOC_D123BCV
	default "d125cbr" if SOC_D125CBR
	default "d125ccv" if SOC_D125CCV
	default "d125ccr" if SOC_D125CCR
	default "d125ddr" if SOC_D125DDR
	default "d125edr" if SOC_D125EDR
	default "d126fbv" if SOC_D126FBV
	default "d126fcv" if SOC_D126FCV

# Family target for SDK boards without a fixed package selection.
config SOC_D12P
	bool
	select SOC_SERIES_D12P

config SOC
	default "d12p" if SOC_D12P
```

## soc/artinchip/d12x/Kconfig.soc
```kconfig
# SPDX-FileCopyrightText: Copyright (c) 2026 UltraSemi Technology Development Co., Ltd.
# SPDX-License-Identifier: Apache-2.0

config SOC_SERIES_D12X
	bool
	select SOC_FAMILY_ARTINCHIP

config SOC_SERIES
	default "d12x" if SOC_SERIES_D12X

config SOC_D12X
	bool
	select SOC_SERIES_D12X

config SOC
	default "d12x" if SOC_D12X
```

## soc/artinchip/d13x/Kconfig
```kconfig
# SPDX-FileCopyrightText: Copyright (c) 2026 UltraSemi Technology Development Co., Ltd.
# SPDX-License-Identifier: Apache-2.0

config SOC_SERIES_D13X
	select CACHE_MANAGEMENT
	select CLOCK_CONTROL
	select CPU_XUANTIE_E907
	select DMA
	select FPU
	select PINCTRL
	select RESET
	select RISCV
```

## soc/artinchip/d13x/Kconfig.soc
```kconfig
# SPDX-FileCopyrightText: Copyright (c) 2026 UltraSemi Technology Development Co., Ltd.
# SPDX-License-Identifier: Apache-2.0

config SOC_SERIES_D13X
	bool
	select SOC_FAMILY_ARTINCHIP
	help
	  Enable support for the ArtInChip D13x SoC series.

config SOC_SERIES
	default "d13x" if SOC_SERIES_D13X

config SOC_D133CBS
	bool
	select SOC_SERIES_D13X

config SOC
	default "d133cbs" if SOC_D133CBS

# Family target for SDK boards without a fixed package selection.
config SOC_D13X
	bool
	select SOC_SERIES_D13X

config SOC
	default "d13x" if SOC_D13X
```

## soc/artinchip/d21x/Kconfig
```kconfig
# SPDX-FileCopyrightText: Copyright (c) 2026 UltraSemi Technology Development Co., Ltd.
# SPDX-License-Identifier: Apache-2.0

config SOC_SERIES_D21X
	select RISCV
	select FPU
	select CPU_HAS_ICACHE
	select CPU_HAS_DCACHE
	select RISCV_PRIVILEGED
	select RISCV_ISA_RV64I
	select INCLUDE_RESET_VECTOR
	select RISCV_HAS_PLIC
	select RISCV_MACHINE_TIMER
	select SOC_EARLY_INIT_HOOK
```

## soc/artinchip/d21x/Kconfig.defconfig
```kconfig
# SPDX-FileCopyrightText: Copyright (c) 2026 UltraSemi Technology Development Co., Ltd.
# SPDX-License-Identifier: Apache-2.0

if SOC_SERIES_D21X

config ICACHE
	default n

config DCACHE
	default n

config NUM_IRQS
	default 108

config 2ND_LVL_ISR_TBL_OFFSET
	default 12

config 2ND_LVL_INTR_00_OFFSET
	default 11

config MAX_IRQ_PER_AGGREGATOR
	default 96

config RISCV_MACHINE_TIMER_READ_TIME_CSR
	default y

endif # SOC_SERIES_D21X
```

## soc/artinchip/d21x/Kconfig.soc
```kconfig
# SPDX-FileCopyrightText: Copyright (c) 2026 UltraSemi Technology Development Co., Ltd.
# SPDX-License-Identifier: Apache-2.0

config SOC_SERIES_D21X
	bool
	select SOC_FAMILY_ARTINCHIP

config SOC_SERIES
	default "d21x" if SOC_SERIES_D21X

config SOC_D21X
	bool
	select SOC_SERIES_D21X

config SOC
	default "d21x" if SOC_D21X
```

## soc/artinchip/g72x/Kconfig.defconfig
```kconfig
# SPDX-FileCopyrightText: Copyright (c) 2026 UltraSemi Technology Development Co., Ltd.
# SPDX-License-Identifier: Apache-2.0

if SOC_SERIES_G72X

config NUM_IRQS
	default 128

config ARCH_SW_ISR_TABLE_ALIGN
	default 64

config RISCV_MCAUSE_EXCEPTION_MASK
	default 0x3FF

choice CACHE_TYPE
	default ARCH_CACHE
endchoice

config RISCV_ISA_EXT_XTHEAD_CMO
	default y

config RISCV_CUSTOM_CSR_THEAD_CMO
	default y

config RISCV_CUSTOM_CSR_THEAD_CMO_E907
	default y

endif # SOC_SERIES_G72X
```

## soc/artinchip/g72x/Kconfig.soc
```kconfig
# SPDX-FileCopyrightText: Copyright (c) 2026 UltraSemi Technology Development Co., Ltd.
# SPDX-License-Identifier: Apache-2.0

config SOC_SERIES_G72X
	bool
	select SOC_FAMILY_ARTINCHIP

config SOC_SERIES
	default "g72x" if SOC_SERIES_G72X

config SOC_G72X
	bool
	select SOC_SERIES_G72X

config SOC
	default "g72x" if SOC_G72X
```

## soc/artinchip/g73x/Kconfig
```kconfig
# SPDX-FileCopyrightText: Copyright (c) 2026 UltraSemi Technology Development Co., Ltd.
# SPDX-License-Identifier: Apache-2.0

config SOC_SERIES_G73X
	select RISCV
	select FPU
	select CPU_XUANTIE_E907
	select CACHE_MANAGEMENT
```

## soc/artinchip/g73x/Kconfig.soc
```kconfig
# SPDX-FileCopyrightText: Copyright (c) 2026 UltraSemi Technology Development Co., Ltd.
# SPDX-License-Identifier: Apache-2.0

config SOC_SERIES_G73X
	bool
	select SOC_FAMILY_ARTINCHIP

config SOC_SERIES
	default "g73x" if SOC_SERIES_G73X

config SOC_G73X
	bool
	select SOC_SERIES_G73X

config SOC
	default "g73x" if SOC_G73X
```
